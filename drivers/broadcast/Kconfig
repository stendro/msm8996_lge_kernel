## drivers/broadcast/Kconfig
```kconfig
# LGE Broadcast Device Driver Support

menu "LGE Broadcast Device Support"

config LGE_BROADCAST_TDMB
    bool "LGE broadcast TDMB device Driver"
    depends on (MACH_LGE)
    default n
    help
      Select this if you want to use TDMB broadcast service

config LGE_BROADCAST_ISDBT_JAPAN
    bool "Japan full-seg Broadcast service"
    depends on (MACH_LGE)
    default n
    help
      Select this if you want to use Japanese FullSeg mobile broadcast service

source "drivers/broadcast/oneseg/Kconfig"
source "drivers/broadcast/tdmb/Kconfig"
endmenu
```

## drivers/broadcast/tdmb/Kconfig
```kconfig
#menu "BROADCAST_DEVICE"

#
# Broadcast Device Driver Support
#

#menu "BROADCAST_DEVICE"

config LGE_BROADCAST_TDMB_FC8080
    bool "LGE broacast TDMB FC8080 device"
    depends on (LGE_BROADCAST_TDMB && (MACH_MSM8992_P1_KR || MACH_MSM8992_PPLUS_KR || MACH_MSM8996_H1_KR || MACH_MSM8996_ELSA_KR || MACH_MSM8992_P1A4WP_KR))
    default y
    help
      Select this if you want to use broadcast service

config LGE_BROADCAST_TDMB_MTV319
	bool "LGE broacast TDMB MTV319 device"
    depends on (LGE_BROADCAST_TDMB)
    default y
    help
      Select this if you want to use broadcast service
#endmenu
```

## drivers/char/diag/Kconfig
```kconfig
menu "Diag Support"

config DIAG_CHAR
	tristate "char driver interface and diag forwarding to/from modem"
	default m
	depends on USB_G_ANDROID || USB_FUNCTION_DIAG || USB_QCOM_MAEMO
	depends on ARCH_MSM
	depends on POWER_RESET_MSM
	select CRC_CCITT
	help
	 Char driver interface for diag user space and diag-forwarding to modem ARM and back.
	 This enables diagchar for maemo usb gadget or android usb gadget based on config selected.
endmenu

menu "DIAG traffic over USB"

config DIAG_OVER_USB
	bool "Enable DIAG traffic to go over USB"
        depends on ARCH_MSM
	default y
	help
	 This feature helps segregate code required for DIAG traffic to go over USB.
endmenu

menu "HSIC/SMUX support for DIAG"

config DIAGFWD_BRIDGE_CODE
	depends on USB_QCOM_DIAG_BRIDGE || MSM_MHI
	default y
	bool "Enable QSC/9K DIAG traffic over SMUX/HSIC"
	help
	 SMUX/HSIC Transport Layer for DIAG Router
endmenu

menu "LGE DIAG Support"

config LGE_DM_APP
	bool "LGE DM APP Support"
	depends on LGE_STOCK
	default y
	help
	 LGE DM APP Support

config LGE_ACG_CARRIER_CODE
	bool "LGE ACG Carrier Code"
	depends on LGE_STOCK
	depends on MACH_MSM8996_H1_LRA_US
	default y
	help
	 LGE ACG Carrier Code

config LGE_DIAG_BYPASS
	tristate "Support LGE diag bypass for factory"
	depends on LGE_STOCK
	default n
	help
	  LGE diag bypass
endmenu
```

## drivers/felica/Kconfig
```kconfig
#platform.team@lge.com	2011.01

comment "LGE Felica selection"

config CXD224X_FELICA_F3
	bool "Felica driver"
	default n
	---help---
	LGE Felica related change
```

## drivers/input/fingerprint/Kconfig
```kconfig
#
# Fingerprints driver configuration
#
menuconfig INPUT_FINGERPRINT
	bool "FingerPrints"
	help
	  Say Y here, and a list of supported fingerprints will be displayed.
	  This option doesn't affect the kernel.

	  If unsure, say Y.

if INPUT_FINGERPRINT

config INPUT_FINGERPRINT_FPC_BTP
	tristate "FPC1022 fingerprint sensor support by CrucialSoft"
	depends on SPI_MASTER
	help
	 Say Y here if you want to support FPC1022
	 connected via an SPI bus.

	 To compile this driver as a module, choose M here: the module
	 will be called FPC1022.

config INPUT_FINGERPRINT_FPC1020
	tristate "FPC1022 fingerprint sensor support by FPC"
	depends on SPI_MASTER
	help
	 Say Y here if you want to support FPC1022
	 connected via an SPI bus.

	 To compile this driver as a module, choose M here: the module
	 will be called FPC1022.

config LGE_USES_NEW_FPC_BLOBS
	bool "LGE Device is using newer FPC blobs"
	depends on INPUT_FINGERPRINT_FPC1020
	help
		Say Y here if the LGE device you're building to has updated
		FPC blobs that require sysfs calls to use the FPC device
		'&fpc1020->input->dev.kobj' instead of '&spi->dev.kobj'

endif
```

## drivers/input/touchscreen/lge/Kconfig
```kconfig
#
# LGE touch core configuration
#

if INPUT_TOUCHSCREEN

menuconfig LGE_TOUCH_CORE
	bool "LGE Touch Core - Generic"
	select LGE_TOUCH_CORE_BASE
	help
	  If your plaform is generic linux, say Y

config LGE_TOUCH_CORE_BASE
	bool "LGE Touch Core Base"
	depends on SPI_MASTER && I2C

source "drivers/input/touchscreen/lge/lgsic/Kconfig"

endif
```

## drivers/input/touchscreen/lge/lgsic/Kconfig
```kconfig
#
# LGE touch core configuration
#
if INPUT_TOUCHSCREEN

menuconfig LGE_TOUCH_LGSIC_LG4945
	bool "LGE Touch Core ODM Device Driver - LG4945"
	depends on LGE_TOUCH_CORE_BASE
	help
	  If your device is lg4945, say Y

menuconfig LGE_TOUCH_LGSIC_LG4946
	bool "LGE Touch Core ODM Device Driver - LG4946"
	depends on LGE_TOUCH_CORE_BASE
	help
	  If your device is lg4946, say Y

menuconfig LGE_TOUCH_LGSIC_SW49407
        bool "LGE Touch Core ODM Device Driver - SW49407"
        depends on LGE_TOUCH_CORE_BASE
        help
          If your device is sw49407, say Y

menuconfig LGE_TOUCH_LGSIC_SW49407_LUCYE
        bool "LGE Touch Core ODM Device Driver - SW49407_Lucy_Panel"
        depends on LGE_TOUCH_CORE_BASE
        help
          If your device is sw49407 + Lucy Panel, say Y

menuconfig LGE_TOUCH_LGSIC_SW49408
        bool "LGE Touch Core ODM Device Driver - SW49408"
        depends on LGE_TOUCH_CORE_BASE
        help
          If your device is sw49408, say Y

# To Do : LGSIC Chipseet
endif
```

## drivers/input/touchscreen/lge/synaptics/Kconfig
```kconfig
#
# LGE touch core configuration
#

if INPUT_TOUCHSCREEN

menuconfig LGE_TOUCH_SYNAPTICS_S3320
	bool "LGE Touch Core ODM Device Driver - Synaptics(s3320)"
	depends on LGE_TOUCH_CORE_BASE
	help
	  If your device is synaptics(s3320), say Y

menuconfig LGE_TOUCH_SYNAPTICS_TD4302
	bool "LGE Touch Core ODM Device Driver - Synaptics(td4302)"
	depends on LGE_TOUCH_CORE_BASE
	help
	  If your device is synaptics(td4302), say Y

endif
```

## drivers/media/platform/msm/Kconfig
```kconfig
source "drivers/media/platform/msm/vidc/Kconfig"

#
# MSM camera configuration
#

comment "Qualcomm MSM Camera And Video"

menuconfig MSM_CAMERA
	bool "Qualcomm MSM camera and video capture support"
	depends on ARCH_MSM && VIDEO_V4L2 && I2C
	---help---
	  Say Y here to enable selecting the video adapters for
	  Qualcomm msm camera and video capture drivers. enabling this
	  adds support for the camera driver stack including sensor, isp
	  and postprocessing drivers for legacy chipsets.

config MSM_CAMERA_DEBUG
	bool "Qualcomm MSM camera debugging with printk"
	depends on MSM_CAMERA
	default n
	---help---
	  Enable printk() debug for msm camera

config MSM_CAMERA_AUTOMOTIVE
	bool "Qualcomm MSM camera for automotive support"
	depends on MSM_CAMERA
	default n
	---help---
	  Enables support for automotive targets

menuconfig MSMB_CAMERA
	bool "Qualcomm MSM camera and video capture 2.0 support"
	depends on ARCH_MSM && VIDEO_V4L2 && I2C
	---help---
	  Say Y here to enable selecting the video adapters for
	  Qualcomm msm camera and video capture 2.0, enabling this
	  adds support for the camera driver stack including sensor, isp
	  and postprocessing drivers.

config OLD_LGE_CAMERA
	bool "LG camera drivers"
	depends on MSMB_CAMERA
	default n
	---help---
	  LG G5 and V20 camera.

config LUCYE_LGE_CAMERA
	bool "LG camera drivers"
	depends on MSMB_CAMERA
	default n
	---help---
	  LG G6 camera.

config MSMB_CAMERA_DEBUG
	bool "Qualcomm MSM camera 2.0 debugging with printk"
	depends on MSMB_CAMERA
	---help---
	  Enable printk() debug for msm camera 2.0

if OLD_LGE_CAMERA
source "drivers/media/platform/msm/camera_v2/Kconfig"
endif # OLD_LGE_CAMERA
if LUCYE_LGE_CAMERA
source "drivers/media/platform/msm/camera_v2_lucye/Kconfig"
endif # LUCYE_LGE_CAMERA
source "drivers/media/platform/msm/dvb/Kconfig"
source "drivers/media/platform/msm/broadcast/Kconfig"
source "drivers/media/platform/msm/sde/Kconfig"
```

## drivers/media/platform/msm/broadcast/Kconfig
```kconfig
#
# MSM Broadcast subsystem drivers
#

config TSPP
	depends on ARCH_MSM
	tristate "TSPP (Transport Stream Packet Processor) Support"
	---help---
	Transport Stream Packet Processor v1 is used to offload the
	processing of MPEG transport streams from the main processor.
	It is used to process incoming transport streams from TSIF
	to supports use-cases such as transport stream live play
	and recording.
	This can also be compiled as a loadable module.

config LGE_BROADCAST_ISDBT_JAPAN
	bool "Japan full-seg Broadcast service"
	depends on (MACH_MSM8992_P1_KDDI_JP || MACH_MSM8996_H1_KDDI_JP || MACH_MSM8996_ELSA_KDDI_JP || MACH_MSM8996_ELSA_DCM_JP || MACH_MSM8998_JOAN_KDDI_JP || MACH_MSM8998_JOAN_DCM_JP || MACH_MSM8952_B5_JP_KDI)
	default y
	help
	  Select this if you want to use Japanese FullSeg mobile broadcast service
```

## drivers/media/platform/msm/vidc/Kconfig
```kconfig
#
# VIDEO CORE
#

menuconfig MSM_VIDC_V4L2
	tristate "Qualcomm MSM V4L2 based video driver"
		depends on ARCH_QCOM && VIDEO_V4L2
		select VIDEOBUF2_CORE

config DEBUG_MSM_VIDC
	bool "Debug VIDC calls"
	depends on DEBUG_KERNEL
	help
	  Say Y here to add some extra checks and diagnostics to vidc calls.
	  These checks help debug cases where vidc might be in an incorrect
	  state, or related to a hardware acceleration problem, as well as 
	  venus states.

source "drivers/media/platform/msm/vidc/vmem/Kconfig"
source "drivers/media/platform/msm/vidc/governors/Kconfig"
```

## drivers/media/radio/rtc6213n_v2/Kconfig
```kconfig
config I2C_RTC6213N_V2
	tristate "Richwave RTC6213N V2 FM Radio Receiver support with I2C"
	depends on I2C && RADIO_RTC6213N_V2
	---help---
	  This is a driver for I2C devices with the Richwave RTC6213N
	  chip.

	  Say Y here if you want to connect this type of radio to your
	  computer's I2C port.

	  To compile this driver as a module, choose M here: the
	  module will be called radio-i2c-RTC6213N_V2.
```

## drivers/mmc/Kconfig
```kconfig
#
# MMC subsystem configuration
#

menuconfig MMC
	tristate "MMC/SD/SDIO card support"
	depends on HAS_IOMEM
	help
	  This selects MultiMediaCard, Secure Digital and Secure
	  Digital I/O support.

	  If you want MMC/SD/SDIO support, you should say Y here and
	  also to your specific host controller driver.

config MMC_DEBUG
	bool "MMC debugging"
	depends on MMC != n
	help
	  This is an option for use by developers; most people should
	  say N here.  This enables MMC core and driver debugging.

config MMC_PERF_PROFILING
	bool "MMC performance profiling"
	depends on MMC != n
	default n
	help
	  If you say Y here, support will be added for collecting
	  performance numbers at the MMC Queue and Host layers.

# LGE_CHANGE_S : bohyun.jung@lge.com
config LGE_MMC_RESET_IF_HANG
    bool "MMC Reset if eMMC is hang. "
    default n
    help
        Reset eMMC if eMMC is unaccessible.
        continously error on cache flush or mmc restart cmd.

config LGE_MMC_DYNAMIC_LOG
    bool "MMC debugging - enable logs through adb"
    default n
    help
        If you say Y here, developers can enable/disable mmc logs through adb
        by accessing /sys/module/mmc_core/parameters/debug_level
        ex. echo {debug_level} > /sys/module/mmc_core/parameters/debug_level
# LGE_CHANGE_E : bohyun.jung@lge.com

config LGE_MMC_SPECIAL_SDR104
        bool "SPECICAL SRD104 SDCARD need wating time for initialization (EXPERIMENTAL)"
	default n
	help
          IF you say Y here, MMC driver will send status command after
	  SDCARD initialization. If device is recieved sucess response,
	  will stop sending status command and then SDR104 card is well recognized.
	  It problem is associated with tunning process of mmc card.
	  if you are experiencing issues with SD detection.

config LGE_MMC_CLK_SCALE_DISABLE
	bool "disable clock scaling for mmc"
	default n
	help
	  If you say Y here, clock scaling for mmc device will be disabled.
	  Set Y in kernel/arch/arm/configs/XXXX_defconfig file.

config LGE_SHOW_SDCARD_DETECT_PIN_STATUS
    bool "Show SD Card Detect pin status"
    default n
    help
        Show SD Card Detect pin status at /sys/devices/soc/7864900.sdhci/mmc_host/mmc1/cd_status

config LGE_TRAY_EVENT
    bool "Show SD Card Detect pin status"
    depends on MACH_LGE && LGE_SHOW_SDCARD_DETECT_PIN_STATUS
    default y
    help
        Support the uevent for SD Card TRAY status.

if MMC

source "drivers/mmc/core/Kconfig"

source "drivers/mmc/card/Kconfig"

source "drivers/mmc/host/Kconfig"

endif # MMC
```
