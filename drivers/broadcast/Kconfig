## drivers/net/wireless/bcmdhd_ext/Kconfig
```kconfig
config BCMDHD
	tristate "Broadcom wireless cards support"
	depends on MMC || PCI
	---help---
	  This module adds support for wireless adapters based on
	  Broadcom chipset.

config BCMDHD_SDIO
	bool "SDIO bus interface support"
	depends on BCMDHD && MMC && !BCMDHD_PCIE

config BCMDHD_PCIE
	bool "PCIe bus interface support"
	depends on BCMDHD && PCI


config BCM4359
	bool "Broadcom 4359 wireless cards support"
	depends on BCMDHD && BCMDHD_PCIE
	---help---
	  This module adds support for wireless adapters based on
	  Broadcom 4359 chipset.

config BCMDHD_COB
	bool "Enables COB type support"
	depends on BCMDHD
	default n
	---help---
	  This is configuration for COB type support.

config BCMDHD_OEM_HEADER_PATH
	depends on BCMDHD
	string "OEM custom header path"
	default "soc/qcom/lge/wifi_bcm_lge.h"
	---help---
	  Path of the customer custom header file

config BCMDHD_FW_PATH
	depends on BCMDHD
	string "Firmware path"
	default "/vendor/etc/firmware/fw_bcmdhd.bin"
	---help---
	  Path to the firmware file.

config BCMDHD_NVRAM_PATH
	depends on BCMDHD
	string "NVRAM path"
	default "/vendor/etc/wifi/bcmdhd.cal"
	---help---
	  Path to the calibration file.

config LGE_BCM433X_PATCH
	bool "BCM433X Patch by LGE"
	default y
	depends on BCMDHD

config BCMDHD_CONFIG_PATH
	depends on LGE_BCM433X_PATCH
	string "Config path"
	default "/data/misc/wifi/config"
	---help---
	  Path to the config file.

config BCMDHD_GPIO_WL_RESET
	depends on BCMDHD
	int "GPIO to the Reset"
	default 82
	---help---
	  GPIO to the Reset

config BCMDHD_HOSTWAKEUP_USE_GPIO
	depends on BCMDHD && BCMDHD_SDIO
	bool "Use GPIO to Host Wakeup"
	default y
	---help---
	  Use GPIO to Host Wakeup

config BCMDHD_GPIO_WL_HOSTWAKEUP
	depends on BCMDHD && BCMDHD_HOSTWAKEUP_USE_GPIO = y && BCMDHD_SDIO
	int "GPIO to the Host Wakeup"
	default 81
	---help---
	  GPIO to the Host Wakeup

config BCMDHD_HW_OOB
	depends on BCMDHD && BCMDHD_HOSTWAKEUP_USE_GPIO = y && BCMDHD_SDIO
	bool "Use H/W OOB to the Host Wakeup"
	default y
	---help---
	  Use H/W OOB to the Host Wakeup

config BRCM_CCX
	depends on BCMDHD
	bool "Enables CCX support"
	default n
	---help---
	  Enables CCX support

config BCMDHD_USE_SCHED_SCAN
	bool "Use CFG80211 sched scan"
	depends on BCMDHD && CFG80211
	default n
	---help---
	  Use CFG80211 sched scan

config BROADCOM_WIFI_RESERVED_MEM
	bool "BROADCOM Reserved memory for wifi device"
	depends on BCMDHD
	default y
	---help---
	  This is a configuration for broadcom WLAN driver.

config BCMDHD_PREALLOC_PKTIDMAP
	bool "BROADCOM PCIE specific memory reserved for PKTIDMAP"
	depends on BROADCOM_WIFI_RESERVED_MEM && BCMDHD_PCIE
	default y
	---help---
	  Preallocated memory support for PCIE interface in Broadcom
	  WLAN driver.

config BCMDHD_PREALLOC_MEMDUMP
	bool "BROADCOM PCIE specific memory reserved for MEMDUMP"
	depends on BROADCOM_WIFI_RESERVED_MEM
	---help---
	  Preallocated memory support for dongle memory dump

config BCM4335BT
	bool "BROADCOM BTLOCK Enable"
	depends on BCM4335
	default y
	---help---
	  This is a configuration for bt lock enable.

config BRCM_WAPI
        bool "Enables WAPI support"
        depends on BCMDHD
        default n
        ---help---
          Enables WAPI support

config BCMDHD_HOSTAPD_BGN_MODE
	bool "Enables BGN mode support in HOSTAPD"
	depends on BCMDHD
	default y
	---help---
	  This is a configuration for support B/BG/BGN mode in HOSTAPD

config RUNTIME_TCPACK_SUPPRESS
	bool "Enabling a feture to dynamically control on/off of TCPACK_SUPPRESS on framework"
	depends on BCMDHD && BCMDHD_PCIE
	default n
	---help---
	  Enables debugability features

config BCMDHD_CLM_PATH
	depends on BCM4359
	string "CLM BLOB path"
	default "/vendor/etc/wifi/4359_lg.clm_blob"
	---help---
	  Path to the clm blob file.

config BCMDHD_DYNAMIC_MUMIMO_CONTROL
	bool "control dynamic mumimo"
	depends on BCM4359
	default n
	---help---
	  enable dynamic mumimo.

config BCMDHD_FOLLOW_AP_DTIM_PERIOD
	bool "DTIM Listen interval in suspend mode"
	depends on BCMDHD && BCMDHD_PCIE
	default n
	---help---
	  y means follow AP's DTIM period
```

## drivers/nfc/Kconfig
```kconfig
#
# Near Field Communication (NFC) devices
#

menu "Near Field Communication (NFC) devices"
	depends on NFC

endmenu

config LGE_NFC
	bool "NFC Device Enabled for LGE"
	default n

config NFC_BCM2079X
	bool "Broadcom 2079X NFC Controller Driver"
	depends on I2C
	select CRC_CCITT
	help
	  Broadcom 2079X Near Field Communication controller support.

config LGE_NFC_PN547_C2
	bool "PN547 C2 NFC driver"
	depends on I2C
	select CRC_CCITT
	default n
	---help---
	  Say yes if you want PN547 Near Field Communication driver.
	  This is for i2c connected version. If unsure, say N here.

	  To compile this driver as a module, choose m here. The module will
	  be called pn547.

config LGE_NFC_PRESTANDBY
	bool "NFC STANBY MODE"
	default n
	---help---
	  Say yes if you want to change a power state of pn544 to stanby mode in Kernel.
	  If unsure, say N here.

config LGE_NFC_MULTICORE_FASTBOOT
	bool "NFC MultiThread"
	default n
	---help---
	  Say yes if multi thread is applied for pre-standby.
	  If unsure, say N here.

config LGE_NFC_SET_IRQ_WAKEUP
	bool "NFC Set IRQ wakeup when NFC ON"
	default n
	---help---
	  Say yes if Set IRQ Wakeup NFC ON.
	  If unsure, say N here.

config LGE_NFC_DEBUG_MESSAGE
	bool "NFC Debug Message"
	default n

config LGE_NFC_USE_PMIC
	bool "NFC Using PMIC Clock"
	default n
	---help---
	  Say yes if you want to use PMIC Clock.
	  If use XTAL or unsure, say N here.
	  Please refer to [NFC-367] for more details.

config NFC_NQ
	tristate "Qualcomm NCI based NFC Controller Driver for NQx"
	depends on I2C
	help
	  This enables the NFC driver for NQx based devices.
	  This is for i2c connected version. NCI protocol logic
	  resides in the usermode and it has no other NFC dependencies.

config CXD224X_NFC
    tristate "CXD224X NFC driver"
    depends on I2C
    select CRC_CCITT
    default n
    ---help---
      Say yes if you want cxd224x Near Field Communication driver.
      This is for i2c connected version. If unsure, say N here.

      To compile this driver as a module, choose m here. The module will
      be called cxd224x-i2c.

config CXD224X_NFC_VEN
    tristate "CXD224X NFC VEN"
    depends on CXD224X_NFC
    default n
    ---help---
      Say yes if you want to use cxd224x NFC VEN(enable voltage) control.
      If unsure, say N here.

config CXD224X_NFC_RST
    tristate "CXD224X NFC RST"
    depends on CXD224X_NFC
    default y
    ---help---
      Say yes if you want to use cxd224x NFC RST(external XRST pin) control.
```

## drivers/power/lge/Kconfig
```kconfig
config LGE_PM_BATTERY_VENEER
	bool "Apply LGE battery veneer"
	depends on LGE_PM
	default n
	help
	  Say Y here enable support lge battery veneer
```
