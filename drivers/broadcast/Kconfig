## drivers/power/supply/qcom/Kconfig
```kconfig
menu "Qualcomm Technologies Inc Charger and Fuel Gauge support"

config QPNP_SMBCHARGER
	tristate "QPNP SMB Charger driver"
	depends on MFD_SPMI_PMIC
	help
	  Say Y here to enable the dual path switch mode battery charger which
	  supports USB detection and battery charging up to 3A.
	  The driver also offers relevant information to userspace via the
	  power supply framework.

config QPNP_FG
	tristate "QPNP fuel gauge driver"
	depends on MFD_SPMI_PMIC
	help
	  Say Y here to enable the Fuel Gauge driver. This adds support for
	  battery fuel gauging and state of charge of battery connected to the
	  fuel gauge. The state of charge is reported through a BMS power
	  supply property and also sends uevents when the capacity is updated.

config QPNP_FG_GEN3
	tristate "QPNP GEN3 fuel gauge driver"
	depends on MFD_SPMI_PMIC
	help
	  Say Y here to enable the GEN3 Fuel Gauge driver. This adds support
	  for battery fuel gauging and state of charge of battery connected to
	  the fuel gauge. The state of charge is reported through a BMS power
	  supply property and also sends uevents when the capacity is updated.

config SMB135X_CHARGER
	tristate "SMB135X Battery Charger"
	depends on I2C
	help
	  Say Y to include support for SMB135X Battery Charger.
	  SMB135X is a dual path switching mode charger capable of charging
	  the battery with 3Amps of current.
	  The driver supports charger enable/disable.
	  The driver reports the charger status via the power supply framework.
	  A charger status change triggers an IRQ via the device STAT pin.

config SMB1351_USB_CHARGER
	tristate "smb1351 usb charger (with VBUS detection)"
	depends on I2C
	help
	 Say Y to enable support for the SMB1351 switching mode based charger.
	 The driver supports charging control (enable/disable) and
	 charge-current limiting. It also provides USB VBUS detection and
	 notification support. The driver controls SMB1351 via I2C and
	 supports device-tree interface.

config MSM_BCL_CTL
	bool "BCL Framework driver"
	help
	  Say Y here to enable this BCL Framework driver. This driver provides
	  interface, which can be used by the BCL h/w drivers to implement the
	  basic functionalities. This framework abstracts the underlying
	  hardware for the top level modules.

config MSM_BCL_PERIPHERAL_CTL
	bool "BCL driver to control the PMIC BCL peripheral"
	depends on SPMI
	depends on MSM_BCL_CTL
	help
	  Say Y here to enable this BCL PMIC peripheral driver. This driver
	  provides routines to configure and monitor the BCL
	  PMIC peripheral.

config BATTERY_BCL
	tristate "Battery Current Limit driver"
	depends on THERMAL_MONITOR
	help
	  Say Y here to enable support for battery current limit
	  device. The BCL driver will poll BMS if
	  thermal daemon enables BCL.
	  It will notify thermal daemon if IBat crosses Imax threshold.

config QPNP_SMB2
	tristate "SMB2 Battery Charger"
	depends on MFD_SPMI_PMIC
	help
	  Enables support for the SMB2 charging peripheral

config SMB138X_CHARGER
	tristate "SMB138X Battery Charger"
	depends on MFD_I2C_PMIC
	help
	  Say Y to include support for SMB138X Battery Charger.
	  SMB1380 is a dual phase 6A battery charger, and SMB1381 is a single
	  phase 5A battery charger.
	  The driver supports charger enable/disable.
	  The driver reports the charger status via the power supply framework.
	  A charger status change triggers an IRQ via the device STAT pin.

config QPNP_QNOVO
	bool "QPNP QNOVO driver"
	depends on MFD_SPMI_PMIC
	help
	  Say Y here to enable the Qnovo pulse charging engine. Qnovo driver
	  accepts pulse parameters via sysfs entries and programs the hardware
	  module. It also allows userspace code to read diagnostics of voltage
	  and current measured during certain phases of the pulses.

endmenu

menu "LGE MSM8996 Power drivers"

config LGE_PM
	tristate "MSM8996 LGE POWER Feature"
	depends on SPMI || MSM_SPMI
	help
	  Say Y here to enable support for pm8994/pmi8994 chip lge feature.
	  Power Management, Battery charging, Battery Monitoring System
	  with battery FET and fuel gauge.

if LGE_PM

config LGE_PM_FACTORY_CABLE
	tristate "support FACTORY CABLE Feature"
	default n
	depends on MACH_LGE
	help
	  cable detection for factory mode, etc

config LGE_PM_PARALLEL_CHARGING
	tristate "LGE parallel charging feature"
	default n
	depends on MACH_LGE
	help
	  lge parallel charging feature

config LGE_PM_BATTERY_ID_CHECKER
	tristate "Virtual Device for LGE Battery ID Checker"
	depends on LGE_PM
	default n
	help
	  Say Y to enable LGE Battery ID Checker. Manufacturer have their own
	  systematic identification of cell types, and protect the system from
	  problems as using non-standard or unexpected types. so cross-
	  reference battery identification are useful to identify.

config LGE_PM_FACTORY_TESTMODE
	bool "Support factory testmode for AT Command"
	depends on LGE_PM
	default n
	help
	  Say Y to enable factory testmode in qpnp-smbcharger

config LGE_PM_FG_AGE
	tristate "QPNP FG battery age mode"
	depends on LGE_PM
	default n
	help
	  Say Y to enable to battery age mode for DCM.
	  age value is 1 = very good condition
	  age value is 2 = good condition
	  age value is 3 = bad condition

config LGE_PM_FG_ACFA
	tristate "QPNP FG Adapative Cutoff For Aged"
	depends on LGE_PM
	default n
	help
	  Say Y to enable to increase cutoff at init & for aged cell.

config LGE_PM_MAXIM_EVP_CONTROL
	bool "add evp control func."
	default n
	depends on QPNP_SMBCHARGER
	depends on LGE_PM
	help
	  add evp control func.

config LGE_PM_USB_CURRENT_MAX_MODE
	tristate "LGE_PM Support USB current max mode"
	default n
	depends on MACH_LGE
	help
	  Say Y to enable LGE PM USB current max mode
	  for MST, Auto Testing with USB

config LGE_PM_RESTORE_BATT_INFO
       bool "Battery Capacity Scaling"
       depends on LGE_PM
       help
         Say Y here to be able to restore the SOC again,
         if the same battery is removed and inserted again

config LGE_PM_SOC_SCALING
       bool "Battery Capacity Scaling"
       depends on LGE_PM
       help
         Say Y here to enable the battery capacity to be scaled.

config LGE_PM_SOC_RECHARGING_WA
       bool "LGE_PM Support recharging by SOC"
       depends on LGE_PM
       help
         Say Y here to recharging by SOC

config LGE_PM_VZW_REQ
	 tristate "Implementation of power requirements of Verizon"
	 default n
	 help
	   power requirements for Verizon Wireless

config LGE_PM_CHARGERLOGO_WAIT_FOR_FG_INIT
	bool "Wait for FG init in LGE Chargerlogo"
	default n
	depends on LGE_PM
	depends on QPNP_FG
	help
	  It is wait for FG init in LGE Chargerlogo.

config LGE_PM_LLK_MODE
	tristate "Implementation of power requirements of retail mode"
	default n
	help
	  power requirements for Verizon retail mode

config LGE_PM_WAKE_LOCK_FOR_CHG_LOGO
	bool "Wakelocks for LGE Chargerlogo"
	depends on LGE_PM
	help
	  It enables wakelocks for LGE Chargerlogo.

config LGE_PM_BATT_MANAGER
	tristate "LGE battery management feature"
	default n
	depends on LGE_PM
	help
	  lge battery management scenario feature

config LGE_PM_WEAK_BATT_PACK
	bool "support for weak battery pack"
	default n
	depends on LGE_PM
	help
	  support for weak battery pack

config LGE_APPS_PORT_FRIENDS
	tristate "LGE's friend for detection by detecting gpio"
	default n
	depends on LGE_PM
	help
	  For the detection of to detect the LGE's friends by irq

config LGE_APPS_PORT_FRIENDS_ONE_WIRE
	tristate "one wire communication"
	default n
	depends on LGE_PM
	help
	  For the communication of LGE's friends by one wire

config LGE_PM_BATTERY_SWAP
	bool "LGE battery swap feature"
	default n
	depends on LGE_PM
	help
	  lge battery swap feature

config LGE_PM_CYCLE_BASED_CHG_VOLTAGE
	bool "LGE battery cycle based chg voltage change feature"
	default n
	depends on LGE_PM
	help
	  lge battery extending feature

config LGE_PM_SUPPORT_LG_POWER_CLASS
	bool "LG power class driver feature"
	default n
	depends on LGE_PM
	help
	  Support lge power class for charging scenario on LGE

config LGE_PM_STEP_DECREASING_TAPER_CHARGING
	bool "LGE taper charging by decreasing per step"
	default n
	depends on LGE_PM
	help
	  Support taper charging by decreasing per step

config LGE_PM_OTP_SCENARIO_FOR_VZW
	tristate "LGE OTP SCENARIO FOR VZW"
	default n
	depends on LGE_PM
	help
	  Support otp scenario for vzw on LGE

config LGE_PM_OTP_SCENARIO_FOR_SPRINT
	tristate "LGE OTP SCENARIO FOR SPRINT"
	default n
	depends on LGE_PM
	help
	  Support otp scenario for sprint on LGE

config LGE_PM_EMBEDDED_BATT_ID_ADC
	bool "LGE EMBEDDED BATT ID ADC"
	default n
	depends on LGE_PM
	help
	  For distinguish battery id by adc value

config LGE_PM_WATERPROOF_PROTECTION
	bool "LGE_PM_WATERPROOF_PROTECTION"
	default n
	depends on LGE_PM
	help
	  Support charging suspending when water is detected

config LGE_PM_INCOMPATIBLE_HVDCP_SUPPORT
	bool "LGE_PM_INCOMPATIBLE_HVDCP_SUPPORT"
	default n
	depends on LGE_PM
	help
	  To make normal charging when the incompatible hvdcp connected

config LGE_PM_MIRACAST_MITIGATION
	bool "LGE_PM_MIRACAST_MITIGATION"
	default n
	depends on LGE_PM
	help
	  Support charging mitigation for miracast

endif # LGE_PM
endmenu

source "drivers/power/supply/qcom/lge/Kconfig"
```

## drivers/slimbus/Kconfig
```kconfig
#
# SLIMBUS driver configuration
#
config DEBUG_SLIMBUS
	bool "Debug slimbus calls"
	depends on DEBUG_KERNEL
	help
	  Say Y here to add some extra checks and diagnostics to slimbus
	  calls.

menuconfig SLIMBUS
	bool "Slimbus support"
	depends on HAS_IOMEM
	help
	  Slimbus is standard interface between baseband and
	  application processors and peripheral components in mobile
	  terminals.

if SLIMBUS
config SLIMBUS_MSM_CTRL
	tristate "Qualcomm Slimbus Master Component"
	default n
	help
	  Select driver for Qualcomm's Slimbus Master Component.

config SLIMBUS_MSM_NGD
	tristate "Qualcomm Slimbus Satellite Component"
	help
	  Select driver for Qualcomm's Slimbus Satellite Component.
	  This is light-weight slimbus controller driver responsible for
	  communicating with slave HW directly over the bus using messaging
	  interface, and communicating with master component residing on ADSP
	  for bandwidth and data-channel management.

endif
```

## drivers/soc/qcom/lge/Kconfig
```kconfig
menu "LGE Specific Patches"

config LGE_HALL_IC
	bool "Support LGE Smartcover"
	depends on MACH_LGE
	default y
	help
	  Support sending a device-tree defined gpio code when hall IC
	  is triggered.

endmenu
```

## drivers/soc/qcom/lge/power/Kconfig
```kconfig
config LGE_PM_LGE_POWER_CORE
	bool "Apply LGE Power Core"
	depends on LGE_PM
	default n
	help
	  Say Y here enable support lge power core

config LGE_PM_CHARGING_SCENARIO_DRIVER
	bool "Apply LGE charging scenario driver"
	depends on LGE_PM_LGE_POWER_CORE
	default n
	help
	  Say Y here enable support lge charging scenario

config LGE_PM_BATTERY_DRIVER
	bool "Apply LGE battery driver"
	depends on LGE_PM_LGE_POWER_CORE
	default n
	help
	  Say Y here enable support lge battery

config LGE_PM_LGE_POWER_CLASS_CABLE_DETECT
	tristate "cable detec driver"
	depends on LGE_PM_LGE_POWER_CORE
	default n
	help
	  Say Y here enable support cable detect

config LGE_PM_LGE_POWER_CLASS_ADC_QCT
	tristate "LGE ADC driver for qualcomm solution"
	depends on LGE_PM_LGE_POWER_CORE
	default n
	help
	  Say Y here enable support lge adc for qualcomm

config LGE_PM_ADC_MTK
	tristate "LGE ADC driver for MTK solution"
	depends on LGE_PM_LGE_POWER_CORE
	default n
	help
	  Say Y here enable support lge adc for MTK

config LGE_PM_ADC_INTEL
	tristate "LGE ADC driver for INTEL solution"
	depends on LGE_PM_LGE_POWER_CORE
	default n
	help
	  Say Y here enable support lge adc for INTEL

config LGE_PM_CHARGING_LPC_BQ24296
	tristate "BQ24296 driver for LG Power Class"
	depends on LGE_PM_LGE_POWER_CORE
	default n
	help
	  Say Y here enable support bq24296 driver for LG Power Class

config LGE_PM_LGE_POWER_CLASS_CHARGING_CONTROLLER
	tristate "LGE charging controller driver for LG Power Class"
	depends on LGE_PM_LGE_POWER_CORE
	default n
	help
	  Say Y here enable support charging controller for LG Power Class

config LGE_PM_LGE_POWER_CLASS_BATTERY_ID_CHECKER
	tristate "Battery ID checker driver for LG Power Class"
	depends on LGE_PM_LGE_POWER_CORE
	default n
	help
	  Say Y here enable support battery id checker driver for LG Power Class

config LGE_PM_LGE_POWER_CLASS_DOCK
	tristate "DOCK driver for LG Power Class"
	depends on LGE_PM_LGE_POWER_CORE
	default n
	help
	  Say Y here enable support DOCK driver for LG Power Class

config LGE_PM_LGE_POWER_CLASS_UEVENT
	tristate "UEVENT driver for LG Power Class"
	depends on LGE_PM_LGE_POWER_CORE
	default n
	help
	  Say Y here enable support UEVENT driver for LG Power Class

config LGE_PM_LGE_POWER_CLASS_VZW_REQ
	tristate "VZW requirement driver for LG Power Class"
	depends on LGE_PM_LGE_POWER_CORE
	default n
	help
	  Say Y here enable support VZW requirement driver for LG Power Class

config LGE_PM_LGE_POWER_CLASS_STORE_MODE
	tristate "Store demo mode driver for LG Power Class"
	depends on LGE_PM_LGE_POWER_CORE
	default n
	help
	  Say Y here enable support store mode driver for LG Power Class

config LGE_PM_ONLY_STORE_MODE
	bool "Only store mode on LG Power Class"
	depends on LGE_PM_LGE_POWER_CORE
	default n
	help
	  Say Y here enable support store mode for global live dummy battery

config LGE_PM_LGE_POWER_CLASS_CHARGER_PSY
	bool "Charger Power Supply for LG Power Class"
	depends on LGE_PM_LGE_POWER_CORE
	default n
	help
	  Say Y here enable charger psy used for LG Power Class

config LGE_PM_LGE_POWER_CLASS_BOARD_REVISION
	tristate "board revision driver for LG Power Class"
	depends on LGE_PM_LGE_POWER_CORE
	default n
	help
	  Say Y here enable support board revision driver for LG Power Class

config LGE_PM_LGE_POWER_CLASS_TYPE_HVDCP
	bool "Apply to support hvdcp type"
	depends on LGE_PM_LGE_POWER_CORE
	default n
	help
	  Say Y here enable support hvdcp function for LG Power Class

config LGE_PM_LGE_POWER_CLASS_CHARGER_SLEEP
	bool "Charger Sleep Feature for LG Power Class"
	depends on LGE_PM_LGE_POWER_CORE
	default n
	help
	  Say Y here enable charger sleep feature used for LG Power Class

config LGE_PM_LGE_POWER_CLASS_TDMB_MODE
	bool "tdmb mode Feature for LG Power Class"
	depends on LGE_PM_LGE_POWER_CORE
	default n
	help
	  Say Y here enable tdmb mode feature used for LG Power Class

config LGE_PM_EMBEDDED_BATTERY
    bool "embedded battery"
        depends on LGE_PM
        default n
        help
            Enable embedded battery

config LGE_PM_LGE_POWER_CLASS_SIMPLE
	bool "Simplify LG Power Class"
	depends on LGE_PM_LGE_POWER_CORE
	default n
	help
	  Say Y here enable simplify LG Power Class

config LGE_PM_LGE_POWER_CLASS_PSEUDO_BATTERY
	bool "pseudo battery driver for LG Power Class"
	depends on LGE_PM_LGE_POWER_CORE
	default n
	help
	  Say Y here enable pseudo battery driver for LG Power Class

config LGE_PM_LGE_POWER_CLASS_SUPPORT_CCD
	bool "support CCD"
	depends on LGE_PM_LGE_POWER_CORE
	default n
	help
	  Say Y here enable CCD
```
