## drivers/video/msm/mdss/Kconfig
```kconfig
config FB_MSM_MDSS_WRITEBACK
	bool "MDSS Writeback Panel"
	---help---
	The MDSS Writeback Panel provides support for routing the output of
	MDSS frame buffer driver and MDP processing to memory.

config FB_MSM_MDSS_HDMI_PANEL
	depends on FB_MSM_MDSS
	bool "MDSS HDMI Tx Panel"
	default n
	---help---
	The MDSS HDMI Panel provides support for transmitting TMDS signals of
	MDSS frame buffer data to connected hdmi compliant TVs, monitors etc.

config FB_MSM_MDSS_HDMI_MHL_SII8334
	depends on FB_MSM_MDSS_HDMI_PANEL
	bool 'MHL SII8334 support '
	default n
	---help---
	  Support the HDMI to MHL conversion.
	  MHL (Mobile High-Definition Link) technology
	  uses USB connector to output HDMI content

config FB_MSM_MDSS_MHL3
	depends on FB_MSM_MDSS_HDMI_PANEL
	bool "MHL3 SII8620 Support"
	default n
	---help---
	  Support the SiliconImage 8620 MHL Tx transmitter that uses
	  USB connector to output HDMI content. Transmitter is an
	  i2c device acting as an HDMI to MHL bridge. Chip supports
	  MHL 3.0 standard.

config FB_MSM_MDSS_DSI_CTRL_STATUS
	tristate "DSI controller status check feature"
	---help---
	  Check DSI controller status periodically (default period is 5
	  seconds) by sending Bus-Turn-Around (BTA) command. If DSI controller
	  fails to acknowledge the BTA command, it sends PANEL_ALIVE=0 status
	  to HAL layer to reset the controller.

config FB_MSM_MDSS_EDP_PANEL
	depends on FB_MSM_MDSS
	bool "MDSS eDP Panel"
	---help---
	The MDSS eDP Panel provides support for eDP host controller driver
	which runs in Video mode only and is responsible for transmitting
	frame buffer from host SOC to eDP display panel.

config FB_MSM_MDSS_MDP3
	depends on FB_MSM_MDSS
	bool "MDP3 display controller"
	---help---
	The MDP3 provides support for an older version display controller
	included in latest display sub-system, known as MDSS.

config FB_MSM_MDSS_XLOG_DEBUG
	depends on FB_MSM_MDSS
	bool "Enable MDSS debugging"
	---help---
	The MDSS debugging provides support to enable display debugging
	features to: Dump MDSS registers during driver errors, panic
	driver during fatal errors and enable some display-driver logging
	into an internal buffer (this avoids logging overhead).

config FB_MSM_MDSS_FRC_DEBUG
	depends on DEBUG_FS && FB_MSM_MDSS
	bool "Enable Video FRC debugging"
	default n
	---help---
	The MDSS FRC debugging provides support to enable the deterministic
	frame rate control (FRC) debugging features to: Collect video frame
	statistics and check whether its output pattern matches expected
	cadence.

config LGE_DISPLAY_AOD_SUPPORTED
	bool "Enable AOD function"
	default n
	---help---
	Feature for AOD (Always on Display) scenario.

config LGE_DISPLAY_MARQUEE_SUPPORTED
	bool "Enable MARQUEE function"
	default n
	---help---
	Feature for MARQUEE scenario.

config LGE_DISPLAY_DELAY_SLEW_CONTROL_IN_TTW
	bool "Enable Control for delay and slew in TTW mode"
	default n
	---help---
	Feature for Delay and Slew control.

config LGE_DISPLAY_AOD_USE_QPNP_WLED
	depends on LGE_DISPLAY_AOD_SUPPORTED
	bool "Enable wled feature for AOD"
	default n
	---help---
	Feature for AOD (Always on Display) backlight mode control.

config LGE_LCD_OFF_DIMMING
	bool "Enable LCD DIMMING for FOTA"
	depends on MACH_LGE
	default n
	---help---
	Support for LCD DIMMING (for FOTA)

config LGE_SP_MIRRORING_CTRL_BL
	bool "SP_MIRRORING_CTRL_BL"
	default n
	help
	  if you say yes here you get support for sp mirroring backlight control

config LGE_LCD_TUNING
	bool "Enable LCD Tuning interface only userdebug"
	default n
	---help---
	Support LCD tuning interface userdebug

config LGE_DISPLAY_DYNAMIC_LOG
	depends on LGE_LCD_TUNING
	bool "Dynamic Log"
	depends on MACH_LGE
	default y
	---help---
	If you say Y here, developers can enable/disable display logs through adb
	by accessing /sys/class/graphics/fb0/debug_level
	ex. echo {debug_level} > sys/class/graphics/fb0/debug_level

config LGE_HIGH_LUMINANCE_MODE
	bool "LGE_HIGH_LUMINANCE_MODE"
	default n
	help
	  if you say yes here you get support for high luminance mode

config LGE_PP_SUPPORT_WITH_PARTIAL_UPDATE
	bool "LGE_PP_SUPPORT_WITH_PARTIAL_UPDATE"
	default n
	help
	  if you say yes here you get support Post Processing(Color convert) with Partial Update

config LGE_PP_AD_SUPPORTED
	bool "LGE_ALICE_AD_SUPPORTED"
	default n
	help
	if you say yes here you get support for Display Driver AD function.

config LGE_ENHANCE_GALLERY_SHARPNESS
	bool "CONFIG_LGE_ENHANCE_GALLERY_SHARPNESS"
	depends on MACH_LGE
	default y
	help
	if you say yes here you get support for enhance sharpness at gallery app

config LGE_VSYNC_SKIP
	bool "MDSS VSYNC Skip scheme"
	default n
	---help---
	This feature provides VSYNC skip scheme.

config LGE_LCD_POWER_CTRL
	bool "LCD power control mode"
	depends on MACH_LGE
	default y
	---help---
	if you say yes here you get support for lcd power on/off control.

config LGE_PANEL_RECOVERY
	depends on  LGE_DISPLAY_COMMON
	bool "Panel recovery support"
	depends on MACH_LGE
	default y
	---help---
	if you say yes here, you get support for panel recovery routine.

config LGE_THERMAL_BL_MAX
	bool "LGE_ALICE_THERMAL_BL_MAX"
	default n
	---help---
	if you say yes here you get support for thermal bl max value.

config LGE_LCD_MFTS_MODE
	depends on LGE_LCD_POWER_CTRL
	bool "LCD MFTS mode"
	depends on MACH_LGE
	default y
	---help---
	if you say yes here you get support for lcd mfts control.

config LGE_CAM_PREVIEW_TUNE
	bool "Enable LGE_CAM_PREVIEW_TUNE"
	default n
	---help---
	if you say yes here you get support for enhance low-gradation at camera preview

config LGE_LCD_DYNAMIC_CABC_MIE_CTRL
	bool "LGE_LCD_DYNAMIC_CABC_MIE_CTRL"
	depends on MACH_LGE
	default y
	help
	if you say yes here you get support for cabc, image enhance function dynamic control

config LGE_DISPLAY_READER_MODE
	depends on FB_MSM_MDSS
	bool "LGE reader mode"
	---help---
	The reader mode provides support to change color temperature
	by sending proper cmds to panel.

config LGE_DISPLAY_READER_MONO_MODE
	depends on FB_MSM_MDSS
	bool "LGE reader mono mode"
	---help---
	The reader mode provides support to change mono color
	by sending proper cmds to panel.

config LGE_DISPLAY_SRE_MODE
	depends on FB_MSM_MDSS
	bool "LGE sre mode"
	---help---
	The sre mode provides support to improve outdoor visibility
	by sending proper cmds to panel.

config LGE_DISPLAY_HDR_MODE
	depends on FB_MSM_MDSS
	bool "LGE HDR mode"
	---help---
	The HDR mode provides support to ensure high definition for playing movies
	by sending proper cmds to panel.

config LGE_DISPLAY_DOLBY_MODE
	depends on FB_MSM_MDSS
	bool "LGE Dolby mode"
	---help---
	The Dolby mode provides support to ensure high definition for playing movies
	by sending proper cmds to panel.

config LGE_DISPLAY_LINEAR_GAMMA
	depends on FB_MSM_MDSS
	bool "LGE linear gamma"
	---help---
	The linear gamma mode provides support to change linear gamma
	by sending proper cmds to panel.

config LGE_DISPLAY_SW49408
	depends on FB_MSM_MDSS
	bool "LGE sw49408"
	---help---
	The SW49408 provides support for SW49408 features made by LGE.

config LGE_DISPLAY_COMMON
	depends on FB_MSM_MDSS
	bool "Use LGE DISPLAY COMMON"
	---help---
	The LGE DISPLAY COMMON provides support for common display features made by LGE.

config LGE_DISPLAY_OVERRIDE_MDSS_DSI_PANEL_POWER_ON
	depends on LGE_DISPLAY_COMMON
	bool "Use OVERRIDE MDSS_DSI_PANEL_POWER_ON"
	---help---
	The LGE DISPLAY COMMON provides support for
		ovrriding mdss_dsi_panel_power_on() function.

config LGE_DISPLAY_OVERRIDE_MDSS_DSI_PANEL_POWER_OFF
	depends on LGE_DISPLAY_COMMON
	bool "Use OVERRIDE MDSS_DSI_PANEL_POWER_OFF"
	---help---
	The LGE DISPLAY COMMON provides support for
		ovrriding mdss_dsi_panel_power_off() function.

config LGE_DISPLAY_OVERRIDE_MDSS_DSI_PANEL_ON
	depends on LGE_DISPLAY_COMMON
	bool "Use OVERRIDE MDSS_DSI_PANEL_ON"
	---help---
	The LGE DISPLAY COMMON provides support for
		ovrriding mdss_dsi_panel_on() function.

config LGE_DISPLAY_OVERRIDE_MDSS_DSI_PANEL_OFF
	depends on LGE_DISPLAY_COMMON
	bool "Use OVERRIDE MDSS_DSI_PANEL_OFF"
	---help---
	The LGE DISPLAY COMMON provides support for
		ovrriding mdss_dsi_panel_off() function.

config LGE_DISPLAY_OVERRIDE_MDSS_DSI_PANEL_RESET
	depends on LGE_DISPLAY_COMMON
	bool "Use OVERRIDE MDSS_DSI_PANEL_RESET"
	---help---
	The LGE DISPLAY COMMON provides support for
		ovrriding mdss_dsi_panel_reset() function.

config LGE_DISPLAY_OVERRIDE_MDSS_DSI_CTRL_SHUTDOWN
	depends on LGE_DISPLAY_COMMON
	bool "Use OVERRIDE MDSS_DSI_CTRL_SHUTDOWN"
	---help---
	The LGE DISPLAY COMMON provides support for
		ovrriding mdss_dsi_ctrl_shutdown() function.

config LGE_DISPLAY_H1_COMMON
	depends on LGE_DISPLAY_COMMON
	bool "Use LGE DISPLAY H1 COMMON"
	---help---
	The H1 COMMON provides support for H1 panel

config LGE_DISPLAY_HPLUS_COMMON
	depends on LGE_DISPLAY_COMMON
	bool "Use LGE DISPLAY HPLUS COMMON"
	---help---
	The HPLUS COMMON provides support for HPLUS panel

config LGE_DISPLAY_BL_EXTENDED
     bool "LG DUAL Backlight"
	default n
	---help---
	Support dual backlight

config LGE_EXTERNAL_DISPLAY_BLOCK
	bool "LG EXTERNAL DISPLAY block"
	default n
	---help---
	Support EXTERNAL DISPLAY block

config LGE_DISPLAY_DYN_DSI_MODE_SWITCH
	bool "LG DYNAMIC DSI MODE SWITCH"
	default n
	---help---
	Support Dynamic DSI mode switch

config LGE_DISPLAY_MFTS_DET_SUPPORTED
	bool "LG MFTS Detection"
	default n
	---help---
	Support MFTS Detection

config LGE_DISPLAY_LUCYE_COMMON
	depends on LGE_DISPLAY_COMMON
	bool "Use LGE DISPLAY LUCYE COMMON"
	---help---
	The LUCYE COMMON provides support for 49407 1440X2880 panel

config LGE_DISPLAY_AOD_WITH_MIPI
	bool "Enable AOD_WITH_MIPI"
	default n
	---help---
	Feature for AOD_WITH_MIPI scenario.

config LGE_DP_UNSUPPORT_NOTIFY
	bool "Enable DP UNSUPPORT NOTIFY FEATURE"
	default n
	---help---
	This config is for notification to framework unsupported
	Displayport
```

## drivers/video/slimport/Ctype_anx7816/Kconfig
```kconfig
config SLIMPORT_CTYPE
	tristate "Analogix Slimport transmitter ANX7816 support"
	help
	  Slimport Transmitter is a 2K/4K video transmitter chip
	  over micro-USB connector for smartphone device.

config SLIMPORT_DYNAMIC_HPD
	tristate "ANX7816 support for dynamic HDMI HPD control"
	help
	  Slimport set HPD when cable is connected,
	  HDMI clk is off during slimport cable is not connected

config SLIMPORT_4K_IMPROVEMENT
	tristate "ANX7816 4K performance improvement"
	help
	  If AP support below HDMI 1.4 version, fps difference
	  between video contents and video stream,
	  as 24fps and 30fps, occur 4k performance issue.
	  this change maximize 4k video stream fps to solve this issue

config SLIMPORT_CONSTRAINT_4K_30FPS
	depends on SLIMPORT_COMMON
	default n
	tristate "ANX7816 resoution constraint for 4K"
	help
	  SLIMPORT doesn't support 4K 60Hz fps,
	  so, we downgrade it to 4K 30Hz for slimport specification

config SLIMPORT_HDCP_UEVENT
	depends on SLIMPORT_COMMON
	default y
	tristate "ANX7816 HDCP DONE switch node support"
	help
	  Notifying progress state of SLIMPORT HDCP authenticating to userspace.
```

## drivers/video/slimport/Kconfig
```kconfig
source "drivers/video/slimport/Ctype_anx7816/Kconfig"

config DEBUG_SLIMPORT
	bool "Debug slimport calls"
	depends on DEBUG_KERNEL
	help
	  Say Y here to add some extra checks and diagnostics to
	  slimport drivers. These checks help ensure that the
	  slimport usb video drivers are functioning properly.

config SLIMPORT_COMMON
	tristate "Analogix Slimport transmitter ANX support"
	help
	  Slimport Transmitter is a video transmitter chip
	  over micro-USB connector for smartphone device.
```

## drivers/video/slimport/anx7808/Kconfig
```kconfig
config SLIMPORT_DYNAMIC_HPD
	tristate "ANX7816 support for dynamic HDMI HPD control"
	help
	  Slimport set HPD when cable is connected,
	  HDMI clk is off during slimport cable is not connected

config SLIMPORT_ANX7808
	tristate "Analogix Slimport transmitter ANX7808 support"
	help
	  Slimport Transmitter is a HD video transmitter chip
	  over micro-USB connector for smartphone device.
```

## drivers/video/slimport/anx7816/Kconfig
```kconfig
config SLIMPORT_ANX7816
	tristate "Analogix Slimport transmitter ANX7816 support"
	help
	  Slimport Transmitter is a 2K/4K video transmitter chip
	  over micro-USB connector for smartphone device.

config SLIMPORT_DYNAMIC_HPD
	tristate "ANX7816 support for dynamic HDMI HPD control"
	help
	  Slimport set HPD when cable is connected,
	  HDMI clk is off during slimport cable is not connected

config SLIMPORT_4K_IMPROVEMENT
	tristate "ANX7816 4K performance improvement"
	help
	  If AP support below HDMI 1.4 version, fps difference
	  between video contents and video stream,
	  as 24fps and 30fps, occur 4k performance issue.
	  this change maximize 4k video stream fps to solve this issue
```

## fs/ecryptfs/Kconfig
```kconfig
config ECRYPT_FS
	tristate "eCrypt filesystem layer support"
	depends on KEYS && CRYPTO && (ENCRYPTED_KEYS || ENCRYPTED_KEYS=n)
	select CRYPTO_ECB
	select CRYPTO_CBC
	select CRYPTO_MD5
	help
	  Encrypted filesystem that operates on the VFS layer.  See
	  <file:Documentation/filesystems/ecryptfs.txt> to learn more about
	  eCryptfs.  Userspace components are required and can be
	  obtained from <http://ecryptfs.sf.net>.

	  To compile this file system support as a module, choose M here: the
	  module will be called ecryptfs.

config ECRYPT_FS_MESSAGING
	bool "Enable notifications for userspace key wrap/unwrap"
	depends on ECRYPT_FS
	help
	  Enables the /dev/ecryptfs entry for use by ecryptfsd. This allows
	  for userspace to wrap/unwrap file encryption keys by other
	  backends, like OpenSSL.

config CRYPTO_DEV_HWCRYPTO_FOR_SDCARD
    bool "Enable Qcom HW crypto for sdcard encryption"
    help
      Enables Qcom HW crypto for sdcard encryption.

config CRYPTO_DEV_FOR_H1_SPRINT
    bool "Enable flage for SPRINT"
    help
      This config is only for SPRINT.

config CRYPTO_DEV_KEY_INTEGRITY_CHECK
    bool "Enable flage for key integrity check"
    help
      This config is only for DISA model.

config SD_ENCRYPTION_MANAGER
	bool "Enable LG SDCard encryption for media exception/decryption only"
	depends on ECRYPT_FS
	help
	  LG provides SD card encryption to protect external SD card data.
	  all created data on the external SD card is automatically encrypted by
	  file system (eCryptfs) before committing it to SD card and all reads
	  automatically decrypt data before returning it to the calling process.

config SDP
    bool "Enable Sensitive data protection"
    depends on ECRYPT_FS_MESSAGING
    help
      LG provides Sensitive Data Protection
```

## fs/sdcardfs/Kconfig
```kconfig
config SDCARD_FS
	tristate "sdcard file system"
	depends on BLOCK
	default n
	help
	  Sdcardfs is based on Wrapfs file system.

config SDCARD_FS_ANDROID_M
	bool  "Android M support"
	depends on SDCARD_FS
	default y
	select SDCARD_FS_32BIT_INO
	help
		Sdcardfs supports Android M

config SDCARD_FS_FADV_NOACTIVE
	bool "sdcardfs fadvise noactive support"
	depends on FADV_NOACTIVE
	default y
	help
	  Sdcardfs supports fadvise noactive mode.

config SDCARD_FS_CI_SEARCH
	tristate "sdcardfs case-insensitive search support"
	depends on SDCARD_FS
	default y

config SDCARD_FS_32BIT_INO
	bool
	depends on SDCARD_FS
	default y
	help
		limit inode number to 32-bit

config SDCARD_FS_SUPPORT_SYMLINK
	tristate "sdcardfs symlink support"
	depends on SDCARD_FS
	default y
```
