
qcom,LGE_BLT32_LGC_3300mAh {
	/* #2752821_LGE_BLT32lgc3_3300mAh_averaged_MasterSlave_Jan12th2017*/
	qcom,max-voltage-uv = <4350000>;
	qcom,nom-batt-capacity-mah = <3300>;
	qcom,batt-id-kohm = <20>;
	qcom,batt-scale-criteria = <0xF5>;
	qcom,batt-recharge-threshold = <0xF8>;
	qcom,battery-beta = <4150>;
	qcom,battery-type = "LGE_BLT32_LGC_3300mAh";
	qcom,chg-rslow-comp-c1 = <2746141>;
	qcom,chg-rslow-comp-c2 = <3373325>;
	qcom,chg-rs-to-rslow = <1038188>;
	qcom,chg-rslow-comp-thr = <0x99>;
	qcom,checksum = <0xD3EC>;
	qcom,gui-version = "PMI8996GUI - 1.1.0.4";
	qcom,fg-profile-data = [
		 E0 83 92 7C 
		 84 80 DF 75 
		 54 83 60 30 
		 37 81 B7 8C 
		 30 82 82 99 
		 75 BC 05 C9 
		 5A 0E F5 83 
		 D0 7C 8B 80 
		 B9 75 4C 83 
		 E9 70 51 62 
		 B1 7F 52 82 
		 59 99 6F BC 
		 F3 C8 58 0D 
		 56 0D 0D 5A 
		 CE 6E 71 FD 
		 55 3F 9C 44 
		 02 42 00 00 
		 C7 47 95 3A 
		 AF 31 00 00 
		 00 00 00 00 
		 00 00 00 00 
		 7E 70 F9 6B 
		 25 3A 2E 82 
		 0B 76 27 68 
		 43 58 15 80 
		 4B 75 5A 62 
		 5C 70 C5 B1 
		 1B 9F 62 40 
		 64 A0 71 0C 
		 28 00 FF 36 
		 F0 11 30 03 
		 00 00 00 0C 
	];
};
