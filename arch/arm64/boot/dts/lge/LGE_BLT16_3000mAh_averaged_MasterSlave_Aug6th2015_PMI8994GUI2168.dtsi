
qcom,LGE_BLT16_3000mah_PMI8994_aug6th2015 {
	/* Temporary applied Z2(BLT-16) LGE_BLT16_3000mah_PMI8994_aug6th2015 */
	qcom,max-voltage-uv = <4350001>;
	qcom,nom-batt-capacity-mah = <3000>;
	qcom,batt-id-kohm = <0>;
	qcom,battery-beta = <0>;
	qcom,battery-type = "LGE_BLT16_3000mah_PMI8994_aug6th2015";
	qcom,chg-rslow-comp-c1 = <2112370>;
	qcom,chg-rslow-comp-c2 = <1532868>;
	qcom,chg-rs-to-rslow = <1544685>;
	qcom,chg-rslow-comp-thr = <0x99>;
	qcom,checksum = <0x8FBA>;
	qcom,gui-version = "PMI8994GUI - 2.1.6.8";
	qcom,fg-profile-data = [
		D1 83 21 7C
		53 80 C7 75
		63 83 F5 75
		F3 8A F8 95
		03 82 B4 99
		05 BC AF C3
		52 10 F7 83
		73 7D AD 81
		89 7C 5D 83
		76 67 EA 88
		BD 94 49 82
		8A 98 4B B6
		DD C1 52 14
		DA 0B B0 59
		CE 6E 71 FD
		EE 3F FA 3C
		07 39 00 00
		9F 4C 9E 31
		3F 31 00 00
		00 00 00 00
		00 00 00 00
		59 72 67 71
		3E 64 91 80
		C6 74 71 62
		47 6A 7D 80
		C1 74 DC 61
		8B 75 E4 A8
		26 57 60 CC
		54 A0 71 0C
		28 00 FF 36
		F0 11 30 03
		00 00 00 0C
		];
};

