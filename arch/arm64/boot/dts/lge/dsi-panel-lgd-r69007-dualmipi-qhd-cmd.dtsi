/* Copyright (c) 2014, Code Aurora Forum. All rights reserved.
 *
 * This program is free software; you can redistribute it and/or modify
 * it under the terms of the GNU General Public License version 2 and
 * only version 2 as published by the Free Software Foundation.
 *
 * This program is distributed in the hope that it will be useful,
 * but WITHOUT ANY WARRANTY; without even the implied warranty of
 * MERCHANTABILITY or FITNESS FOR A PARTICULAR PURPOSE.  See the
 * GNU General Public License for more details.
 */

&mdss_mdp {
	dsi_dual_lgd_cmd: qcom,mdss_dsi_lgd_r69007_1440p_mipi_cmd {
		qcom,mdss-dsi-panel-name = "LGD RSP INCELL 1440p Dual cmd mode dsi panel";
		qcom,mdss-dsi-panel-type = "dsi_cmd_mode";
		qcom,mdss-dsi-panel-framerate = <60>;
		qcom,mdss-dsi-virtual-channel-id = <0>;
		qcom,mdss-dsi-stream = <0>;
		qcom,mdss-dsi-panel-width = <720>;
		qcom,mdss-dsi-panel-height = <2560>;
		qcom,mdss-dsi-h-front-porch = <168>;
		qcom,mdss-dsi-h-back-porch = <88>;
		qcom,mdss-dsi-h-pulse-width = <4>;
		qcom,mdss-dsi-h-sync-skew = <0>;
		qcom,mdss-dsi-v-back-porch = <10>;
		qcom,mdss-dsi-v-front-porch = <9>;
		qcom,mdss-dsi-v-pulse-width = <1>;
		qcom,mdss-dsi-h-left-border = <0>;
		qcom,mdss-dsi-h-right-border = <0>;
		qcom,mdss-dsi-v-top-border = <0>;
		qcom,mdss-dsi-v-bottom-border = <0>;
		qcom,mdss-dsi-bpp = <24>;
		qcom,mdss-dsi-color-order = "rgb_swap_rgb";
		qcom,mdss-dsi-underflow-color = <0xff>;
		qcom,mdss-dsi-border-color = <0>;
		qcom,mdss-dsi-h-sync-pulse = <0>;
		qcom,mdss-dsi-traffic-mode = "burst_mode";
		qcom,mdss-dsi-lane-map = "lane_map_0123";
		qcom,mdss-dsi-bllp-eof-power-mode;
		qcom,mdss-dsi-bllp-power-mode;

		/* qcom,cmd-sync-wait-broadcast; */
		/* qcom,cmd-sync-wait-trigger; */
		qcom,dcs-cmd-by-left;

		qcom,mdss-dsi-lane-0-state;
		qcom,mdss-dsi-lane-1-state;
		qcom,mdss-dsi-lane-2-state;
		qcom,mdss-dsi-lane-3-state;
		qcom,mdss-dsi-hor-line-idle = <0 40 256>,
						<40 120 128>,
						<120 240 64>;
		qcom,mdss-dsi-panel-timings = [EB 38 26 01 6A 6C 2C 3C 2F 03 04 00];
		qcom,mdss-dsi-reset-sequence = <1 10>, <0 10>, <1 10>;
		qcom,mdss-dsi-t-clk-post = <0x02>;
		qcom,mdss-dsi-t-clk-pre = <0x2C>;
		qcom,mdss-dsi-bl-max-level = <4095>;
		qcom,mdss-dsi-dma-trigger = "trigger_sw";
		qcom,mdss-dsi-mdp-trigger = "none";
		qcom,mdss-dsi-te-pin-select = <1>;
		qcom,mdss-dsi-wr-mem-start = <0x2c>;
		qcom,mdss-dsi-wr-mem-continue = <0x3c>;
		qcom,mdss-dsi-te-dcs-command = <1>;
		qcom,mdss-dsi-te-check-enable;
		qcom,mdss-dsi-te-using-te-pin;
		qcom,ulps-enabled;
		qcom,mdss-dsi-lp11-init;

		qcom,mdss-dsi-on-command = [
			/* Manufacturer Command Protection */
			29 01 00 00 00 00 02
			B0 00
			/* Interface Control */
			29 01 00 00 00 00 04
			B3 04 00 00
			/* DSI Control */
			29 01 00 00 00 00 04
			B6 3B D3 00
			/* Display Setting 1 */
			29 01 00 00 00 00 28
			C1 80 08 11 1F FC
			F2 C9 1F 5F 98
			B3 FE FF F7 FE
			FF D7 31 F1 CB
			3F 3F FD EF 03
			24 69 18 AA 40
			01 42 02 08 00
			01 00 01 00
			/* Display Setting 2 */
			29 01 00 00 00 00 0F
			C2 01 FA 00 04 64
			08 00 60 00 38
			70 00 00 00
			/* Display Setting 3 Active - V */
			29 01 00 00 00 00 09
			C3 07 01 08 01 00
			00 00 00
			/* Source Timing Setting & Sout Equalize Setting */
			29 01 00 00 00 00 12
			C4 70 00 00 00 02
			00 00 00 00 02
			01 00 01 01 00
			00 00
			/* LTPS Timing Setting */
			29 01 00 00 00 00 11
			C6 3C 00 3C 02 37
			01 0E 01 02 01
			02 03 0F 04 3C
			46
			/* Gamma Setting Common Set */
			29 01 00 00 00 00 1F
			C7 00 16 22 2C 3B
			48 51 5D 40 47
			53 61 6A 71 78
			00 16 22 2C 3B
			48 51 5D 40 47
			53 61 6A 71 78
			/* Digital Gamma Setting 1 */
			29 01 00 00 00 00 14
			C8 00 00 00 00 00
			FC 00 00 00 00
			00 FC 00 00 00
			00 00 FC 00
			/* Digital Gamma Setting 2 */
			29 01 00 00 00 00 14
			C9 00 00 00 00 00
			FC 00 00 00 00
			00 FC 00 00 00
			00 00 FC 00
			/* Panel PIN Control */
			29 01 00 00 00 00 14
			CB AA 1E E3 55 F1
			FF 00 00 00 00
			00 00 00 00 00
			00 00 00 00
			/* Panel IF Control */
			29 01 00 00 00 00 02
			CC 07
			/* V Black Control */
			29 01 00 00 00 00 0B
			CD 3A 86 3A 86 8D
			8D 04 04 00 00
			/* Power Setting(for CHGP) */
			29 01 00 00 00 00 11
			D0 2A 01 91 6A DC
			59 19 00 00 00
			19 99 04 00 00
			00
			/* Power Setting for Internal Power */
			29 01 00 00 00 00 21
			D3 1B 3B BB 77 77
			77 BB B3 33 00
			80 A7 AF 5B 5B
			33 33 33 C0 00
			F2 0F 7D 7C FF
			0F 99 00 33 00
			FF FF
			/* Driving Option and Touch Setting */
			29 01 00 00 00 00 06
			D4 57 33 05 00 FF
			/* Vcom Setting */
			29 01 00 00 00 00 0C
			D5 66 00 00 01 3D
			01 3D 00 38 00
			38
			/* Sequencer Timing Control for Pon */
			29 01 00 00 00 00 22
			D7 04 FF 23 15 75
			A4 C3 1F C3 1F
			D9 07 1C 1F 30
			8E 87 C7 E3 F1
			CC F0 1F F0 0D
			70 00 2A 00 7E
			1D 07 00
			/* Sequencer Test Control */
			29 01 00 00 00 00 02
			D6 01

			/* IE setting Start */
			/* Color Enhancement */
			29 01 00 00 00 00 2C
			CA 1D FC DC DC
			00 FD FD 00 FD
			00 D9 D9 02 E3
			00 00 00 FC 00
			00 00 00 00 00
			00 00 00 00 00
			00 00 00 00 00
			00 00 00 00 00
			00 00 00 00

			/* BACKLIGHT CONTROL */
			//0205_01, 10kHz
			29 01 00 00 00 00 1A
			CE 55 40 46 4E
			57 60 6A 75 81
			8E 9B AA B9 C8
			D8 E6 FF 0A 00
			04 04 42 04 69
			5A


			/* BACKLIGHT CONTROL */
			//CABC, CR15
			29 01 00 00 00 00 08
			B8 45 3D 1A 0F
			0A 50 50 //CABC
			29 01 00 00 00 00 08
			BA 01 33 78 64 00 FF
			FF // SRE

			/* SRE CONTROL */
			29 01 00 00 00 00 03
			BB 14 14
			29 01 00 00 00 00 03
			BC 37 32 // MIDDLE
			29 01 00 00 00 00 03
			BD 64 00 // STRONG

			/* CABC_SRE SETTING */
			39 01 00 00 00 00 02
			53 24
			39 01 00 00 00 00 02
			55 81 //h4b SRE, l2b CABC
			/* IE setting End */

			/* Sleep out & Display on set */
			/* Host display data transfer start(HS) */
			/* Display On */
			05 01 00 00 00 00 01 29
			/* Sleep out & wait 73ms*/
			05 01 00 00 49 00 01 11

			/* CABC dimming on */
			39 01 00 00 00 00 02
			53 2C
			39 01 00 00 00 00 02
			51 FF
			];
		qcom,mdss-dsi-on-command-state = "dsi_lp_mode";
		qcom,mdss-dsi-off-command = [
			/* Sequencer Timing Control for Pon */
			29 01 00 00 00 00 22
			D7 04 FF 23 15 75
			A4 C3 1F C3 1F
			D9 07 1C 1F 30
			8E 87 C7 E3 F1
			CC F0 1F F0 0D
			70 00 7A 00 7E
			1D 07 00

			/* Panel PIN Control */
			29 01 00 00 00 00 0D
			CB AA 1E E3 55 F1
			FF AA 0E C0 55
			01 00

			/* Display off & wait 20ms */
			05 01 00 00 14 00 01 28
			/* Sleep in & wait 70ms */
			05 01 00 00 46 00 01 10
			];
		qcom,mdss-dsi-off-command-state = "dsi_hs_mode";

		qcom,blmap-size = <256>;
		qcom,blmap = <
			  0
			  29 29 29 29 29 29 29 29 29 29
			  29 29 29 30 30 30 31 31 31 32
			  32 32 33 34 35 37 38 39 41 42
			  43 45 46 47 49 51 53 55 57 60
			  62 64 66 68 71 73 75 77 80 84
			  88 93 97 102 106 110 115 119 124 128
			  132 136 141 145 149 154 158 162 166 171
			  175 179 184 190 197 203 210 216 223 229
			  236 242 249 255 262 269 276 283 290 297
			  304 312 319 326 333 340 347 355 365 375
			  385 395 405 415 425 435 445 455 465 475
			  485 495 505 515 525 535 545 555 565 575
			  585 595 607 620 632 645 657 670 683 695
			  708 720 733 746 761 777 792 808 824 839
			  855 871 886 902 920 932 947 962 977 991
			  1006 1021 1036 1050 1065 1080 1095 1110 1127 1145
			  1163 1181 1198 1216 1234 1252 1269 1287 1305 1323
			  1341 1359 1377 1395 1413 1431 1449 1467 1485 1503
			  1521 1539 1558 1580 1602 1624 1647 1669 1691 1713
			  1736 1758 1780 1802 1825 1846 1868 1890 1912 1934
			  1956 1978 2000 2022 2044 2066 2088 2110 2138 2166
			  2194 2222 2250 2279 2307 2335 2363 2391 2420 2446
			  2472 2498 2524 2550 2576 2602 2628 2654 2680 2706
			  2732 2758 2788 2818 2848 2878 2908 2939 2969 2999
			  3029 3059 3089 3120 3155 3190 3225 3260 3295 3330
			  3365 3400 3435 3470 3505
		>;
		qcom,mdss-pan-physical-width-dimension = <68>;
		qcom,mdss-pan-physical-height-dimension = <121>;
	};
};
