/* Copyright (c) 2014, The Linux Foundation. All rights reserved.
 *
 * This program is free software; you can redistribute it and/or modify
 * it under the terms of the GNU General Public License version 2 and
 * only version 2 as published by the Free Software Foundation.
 *
 * This program is distributed in the hope that it will be useful,
 * but WITHOUT ANY WARRANTY; without even the implied warranty of
 * MERCHANTABILITY or FITNESS FOR A PARTICULAR PURPOSE.  See the
 * GNU General Public License for more details.
 */

&i2c_6{

	lm3697@36 {
		compatible = "backlight,lm3697";
		status = "ok";
		reg = <0x36>;
		lm3697,lcd_bl_en = <&pm8994_gpios 12 0x00>;
		lm3697,max_current = <0x13>;
		lm3697,min_brightness = <0x01>;
		lm3697,default_brightness = <0x2E>;
		lm3697,max_brightness = <0xFF>;
		lm3697,output_config = <0x04>;
		lm3697,brightness_config = <0x00>;
		lm3697,sink_feedback = <0x00>;
		lm3697,boost_ctrl = <0x04>;
		lm3697,enable_pwm = <0>;
	};
};
