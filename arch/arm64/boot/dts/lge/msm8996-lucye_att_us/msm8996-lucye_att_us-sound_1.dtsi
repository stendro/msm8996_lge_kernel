/* Copyright (c) 2015, The Linux Foundation. All rights reserved.
 *
 * This program is free software; you can redistribute it and/or modify
 * it under the terms of the GNU General Public License version 2 and
 * only version 2 as published by the Free Software Foundation.
 *
 * This program is distributed in the hope that it will be useful,
 * but WITHOUT ANY WARRANTY; without even the implied warranty of
 * MERCHANTABILITY or FITNESS FOR A PARTICULAR PURPOSE.  See the
 * GNU General Public License for more details.
 */

////////////////////////////////////////////////////////////////////////////
// 2016 04 11
// You have to check each Revision Sound dtsi file in ../msm8996-sound/
//
////////////////////////////////////////////////////////////////////////////

#include "../msm8996-sound/msm8996-lucye-sound_fmradio.dtsi"
&soc {
//Enable i2c_1 if FM Chip is installed
  i2c_1: i2c@7575000 {
    silabs4709@10 { /* SiLabs FM chip, slave id 0x10*/
        status = "ok";
      };
    };

  i2c_1: i2c@7575000 {
   rtc6213n@64 { /* Richwave FM Radio chip, slave id 0x64*/
        status = "disabled";
      };
    };
};

