/* Copyright (c) 2015, The Linux Foundation. All rights reserved.
 *
 * This program is free software; you can redistribute it and/or modify
 * it under the terms of the GNU General Public License version 2 and
 * only version 2 as published by the Free Software Foundation.
 *
 * This program is distributed in the hope that it will be useful,
 * but WITHOUT ANY WARRANTY; without even the implied warranty of
 * MERCHANTABILITY or FITNESS FOR A PARTICULAR PURPOSE.  See the
 * GNU General Public License for more details.
 */

&mdss_hdmi_tx {
	pinctrl-names = "hdmi_hpd_active", "hdmi_ddc_active", "hdmi_cec_active",
				"hdmi_active", "hdmi_sleep";
	pinctrl-0 = <&mdss_hdmi_hpd_active &mdss_hdmi_ddc_suspend
						&mdss_hdmi_cec_suspend>;
	pinctrl-1 = <&mdss_hdmi_hpd_active &mdss_hdmi_ddc_active
						&mdss_hdmi_cec_suspend>;
	pinctrl-2 = <&mdss_hdmi_hpd_active &mdss_hdmi_cec_active
						&mdss_hdmi_ddc_suspend>;
	pinctrl-3 = <&mdss_hdmi_hpd_active &mdss_hdmi_ddc_active
						&mdss_hdmi_cec_active>;
	pinctrl-4 = <&mdss_hdmi_hpd_suspend &mdss_hdmi_ddc_suspend
						&mdss_hdmi_cec_suspend>;
};

&i2c_6 {
	analogix_anx7688_slimport@72 {
	compatible = "analogix,anx7688_slimport";
	status = "ok";
	reg = <0x72>;
	//interrupt-parent = <&tlmm>;
	//interrupts = <46 0x2>;
	//analogix,reset-gpio = <&tlmm 16 0x00>;	//SLIMPORT_RESET_N
	//analogix,intr-comm-gpio = <&tlmm 46 0x00>;	//SLIMPORT_INT_N, refer to intr_comm_gpio
	//analogix,p-on-gpio = <&tlmm 130 0x0>;	//SLIMPORT_POWER_EN
	//analogix,cbl-det-gpio = <&tlmm 131 0x0>;
	//analogix,vdd_dig-supply = <&pm8994_l27>; //DVDD10
	//lge,external-ldo-control = <0>;
	analogix,i2c-pull-up = <1>;
	qcom,hdmi-tx-map = <&mdss_hdmi_tx>;

	pinctrl-names = "default", "sleep";
	pinctrl-0	= <&anx7688_hpd_active>;
	pinctrl-1	= <&anx7688_hpd_sleep>;
	};
};
