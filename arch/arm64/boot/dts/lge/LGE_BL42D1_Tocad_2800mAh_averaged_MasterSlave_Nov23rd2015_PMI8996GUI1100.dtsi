
qcom,lge_bl42d1_tocad_2800mah_averaged_masterslave_nov23rd2015 {
	/* #2221136_LGE_BL42D1_Tocad_2800mAh_averaged_MasterSlave_Nov23rd2015*/
	qcom,max-voltage-uv = <4400000>;
	qcom,nom-batt-capacity-mah = <2800>;
	qcom,batt-id-kohm = <0>;
	qcom,battery-beta = <4150>;
	qcom,battery-type = "lge_bl42d1_tocad_2800mah_averaged_masterslave_nov23rd2015";
	qcom,chg-rslow-comp-c1 = <3786129>;
	qcom,chg-rslow-comp-c2 = <6278308>;
	qcom,chg-rs-to-rslow = <936929>;
	qcom,chg-rslow-comp-thr = <0xB2>;
	qcom,checksum = <0x7701>;
	qcom,gui-version = "PMI8996GUI - 1.1.0.0";
	qcom,fg-profile-data = [
		 DB 83 99 7C
		 E4 80 CB 76
		 63 83 32 75
		 67 8A 75 95
		 2F 82 11 99
		 4B B7 05 C3
		 52 16 EF 83
		 E3 7C 0D 81
		 11 77 6E 83
		 E8 75 2A 8B
		 36 96 36 82
		 61 9A BD BD
		 E2 CA 52 0F
		 BA 0A C6 5A
		 14 70 71 FD
		 36 2A 78 46
		 97 38 00 00
		 3C 47 75 08
		 AF 39 00 00
		 00 00 00 00
		 00 00 00 00
		 CD 69 C1 68
		 FA 6D 36 82
		 FB 75 B1 68
		 B2 6D 1D 7B
		 6C 75 16 68
		 01 84 8A AA
		 1A 69 68 72
		 66 A0 71 0C
		 28 00 FF 36
		 F0 11 30 03
		 00 00 00 0C
	];
};
