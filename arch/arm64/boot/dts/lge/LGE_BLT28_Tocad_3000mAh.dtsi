qcom,2550270_lge_anna_blt28_3000mah_averaged_masterslave_aug4th2016 {
	/* #2550270_LGE_Anna_BLT28_3000mAh_averaged_MasterSlave_Aug4th2016*/
	qcom,max-voltage-uv = <4400000>;
	qcom,nom-batt-capacity-mah = <3000>;
	qcom,batt-id-kohm = <0>;
	qcom,battery-beta = <3435>;
	qcom,battery-type = "LGE_BLT28_Tocad_3000mAh";
	qcom,chg-rslow-comp-c1 = <3282251>;
	qcom,chg-rslow-comp-c2 = <4955460>;
	qcom,chg-rs-to-rslow = <1051615>;
	qcom,chg-rslow-comp-thr = <0xAB>;
	qcom,checksum = <0xCD8B>;
	qcom,gui-version = "PMI8996GUI - 1.1.0.2";
	qcom,fg-profile-data = [
		D8 83 7B 7C
		C5 80 8A 76
		66 83 DE 75
		BF 8A B4 95
		15 82 47 9A
		2A BD AF C9
		54 11 F5 83
		F4 7C FB 80
		C8 76 5B 83
		41 58 DB 81
		CB 8D 48 82
		7A 9A 51 BE
		23 D0 58 0D
		9E 0B C2 5B
		14 70 71 FD
		7B 28 1C 47
		8E 3A 00 00
		3D 4C 75 08
		8E 42 00 00
		00 00 00 00
		00 00 00 00
		42 70 3B 6B
		0A 4D 65 81
		7E 75 A3 69
		E0 5B D1 80
		57 74 CD 62
		F8 74 B3 AB
		1A 91 68 32
		66 A0 71 0C
		28 00 FF 36
		F0 11 30 03
		00 00 00 0C
	];
};
