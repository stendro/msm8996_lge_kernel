/* Copyright (c) 2015, The Linux Foundation. All rights reserved.
 *
 * This program is free software; you can redistribute it and/or modify
 * it under the terms of the GNU General Public License version 2 and
 * only version 2 as published by the Free Software Foundation.
 *
 * This program is distributed in the hope that it will be useful,
 * but WITHOUT ANY WARRANTY; without even the implied warranty of
 * MERCHANTABILITY or FITNESS FOR A PARTICULAR PURPOSE.  See the
 * GNU General Public License for more details.
 */

#include "../msm8996-usb-typec-anx7688.dtsi"

&usb2s {
	status = "disabled";

	dwc3@7600000 {
		dr_mode = "host";
	};
};

&qusb_phy0 {
	qcom,qusb-phy-tune = <0xF8 0x23 0x83 0xC5>;
	qcom,qusb-phy-tune-host = <0xF8 0x73 0x83 0xC5>;
};
