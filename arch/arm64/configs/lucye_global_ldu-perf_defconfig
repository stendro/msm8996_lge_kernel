## arch/arm64/configs/lucye_global_ldu_dac-debug_defconfig
```kconfig
include lucye_global_ldu_dac_common
include lucye_common-debug
CONFIG_MEM_SHARE_QMI_SERVICE=y
```

## arch/arm64/configs/lucye_lgu_kr-debug_defconfig
```kconfig
include lucye_lgu_kr_common
include lucye_common-debug
CONFIG_NF_CT_NETLINK_HELPER=y
CONFIG_NETFILTER_NETLINK_QUEUE=y
CONFIG_NETFILTER_NETLINK_GLUE_CT=y
CONFIG_NETFILTER_XT_TARGET_CT=y
```

## arch/arm64/configs/lucye_lgu_kr-perf_defconfig
```kconfig
include lucye_lgu_kr_common
include lucye_common-perf
CONFIG_NF_CT_NETLINK_HELPER=y
CONFIG_NETFILTER_NETLINK_QUEUE=y
CONFIG_NETFILTER_NETLINK_GLUE_CT=y
CONFIG_NETFILTER_XT_TARGET_CT=y
```

## arch/arm64/configs/lucye_spr_us-debug_defconfig
```kconfig
include lucye_spr_us_common
include lucye_common-debug
CONFIG_MEM_SHARE_QMI_SERVICE=y
```

## arch/arm64/configs/lucye_trf_us_vzw-debug_defconfig
```kconfig
include lucye_trf_us_vzw_common
include lucye_common-debug
CONFIG_MEM_SHARE_QMI_SERVICE=y
```

## arch/arm64/configs/lucye_vzw-debug_defconfig
```kconfig
include lucye_vzw_common
include lucye_common-debug
CONFIG_MEM_SHARE_QMI_SERVICE=y
```

## arch/arm64/configs/mk2000_defconfig
```kconfig
# Disable stuff
CONFIG_AIO=n
CONFIG_EFI=n
CONFIG_JBD=n
CONFIG_ESOC=n
CONFIG_AUDIT=n
CONFIG_ATL1C=n
CONFIG_IMX134=n
CONFIG_IMX132=n
CONFIG_OV9724=n
CONFIG_OV5648=n
CONFIG_GC0339=n
CONFIG_OV8825=n
CONFIG_OV8865=n
CONFIG_s5k4e1=n
CONFIG_OV12830=n
CONFIG_BONDING=n
CONFIG_MODULES=n
CONFIG_RD_LZMA=n
CONFIG_WIL6210=n
CONFIG_VGA_ARB=n
CONFIG_EXT2_FS=n
CONFIG_EXT3_FS=n
CONFIG_MSM_11AD=n
CONFIG_MMC_TEST=n
CONFIG_RD_BZIP2=n
CONFIG_MSM_RDBG=n
CONFIG_PROFILING=n
CONFIG_ATH_CARDS=n
CONFIG_CPU_BOOST=n
CONFIG_ARM64_PAN=n
CONFIG_ARM64_UAO=n
CONFIG_CORESIGHT=n
CONFIG_TRACER_PKT=n
CONFIG_SPI_SPIDEV=n
CONFIG_TI_DRV2667=n
CONFIG_SEEMP_CORE=n
CONFIG_MEDIA_TUNER=n
CONFIG_CNSS_CRYPTO=n
CONFIG_CMA_DEBUGFS=n
CONFIG_EEPROM_AT24=n
CONFIG_CLD_LL_CORE=n
CONFIG_INPUT_EVBUG=n
CONFIG_IOMMU_DEBUG=n
CONFIG_MSM_QBT1000=n
CONFIG_IPC_LOGGING=n
CONFIG_SCSI_LOGGING=n
CONFIG_IOSCHED_TEST=n
CONFIG_USB_EHCI_HCD=n
CONFIG_WIRELESS_EXT=n
CONFIG_SECURE_TOUCH=n
CONFIG_RADIO_SILABS=n
CONFIG_WCD9330_CODEC=n
CONFIG_SCSI_UFS_TEST=n
CONFIG_UEVENT_HELPER=n
CONFIG_SYSFS_SYSCALL=n
CONFIG_ARM_GIC_V3_ACL=n
CONFIG_MMC_BLOCK_TEST=n
CONFIG_MSM_PERFORMANCE=n
CONFIG_LCD_CLASS_DEVICE=n
CONFIG_NL80211_TESTMODE=n
CONFIG_INPUT_HBTP_INPUT=n
CONFIG_BACKLIGHT_GENERIC=n
CONFIG_LOCALVERSION_AUTO=n
CONFIG_MSM_KERNEL_PROTECT=n
CONFIG_MMC_PERF_PROFILING=n
CONFIG_WCNSS_MEM_PRE_ALLOC=n
CONFIG_CC_OPTIMIZE_FOR_SIZE=n
CONFIG_ARM64_ERRATUM_826319=n
CONFIG_ARM64_ERRATUM_827319=n
CONFIG_ARM64_ERRATUM_824069=n
CONFIG_ARM64_ERRATUM_819472=n
CONFIG_ARM64_ERRATUM_832075=n
CONFIG_ARM64_ERRATUM_845719=n
CONFIG_ARM64_ERRATUM_843419=n
CONFIG_TOUCHSCREEN_ATMEL_MXT=n
CONFIG_CPU_FREQ_GOV_USERSPACE=n
CONFIG_USB_EHSET_TEST_FIXTURE=n
CONFIG_WLAN_FEATURE_RX_WAKELOCK=n
CONFIG_CPU_FREQ_GOV_CONSERVATIVE=n
CONFIG_CRYPTO_AES_ARM64_NEON_BLK=n
CONFIG_TOUCHSCREEN_ATMEL_MAXTOUCH_TS=n
CONFIG_TOUCHSCREEN_SYNAPTICS_DSX_v21=n
CONFIG_TOUCHSCREEN_SYNAPTICS_DSX_v26=n

# Disable verity
CONFIG_DM_VERITY=n

# Enable stuff
CONFIG_JUMP_LABEL=y
CONFIG_PERF_EVENTS=y
CONFIG_LOCALVERSION="-"
CONFIG_TCP_CONG_WESTWOOD=y
CONFIG_CRYPTO_ANSI_CPRNG=y
CONFIG_EXT4_USE_FOR_EXT23=y
CONFIG_SYSTEM_TRUSTED_KEYRING=y
CONFIG_BUILD_ARM64_KERNEL_COMPRESSION_LZ4=y
```

## arch/arm64/configs/old_NOS/elsa_storage_type_emmc_defconfig
```kconfig
# ADDITIONAL OPTIONS - START
# CONFIG_SCSI_UFSHCD is not set
# CONFIG_SCSI_UFSHCD_PLATFORM is not set
# CONFIG_SCSI_UFS_QCOM is not set
# CONFIG_SCSI_UFS_QCOM_ICE is not set
# CONFIG_UFS_LGE_FEATURE is not set
# CONFIG_UFS_FAULT_INJECTION is not set
# ADDITIONAL OPTIONS - END
CONFIG_QCOM_SMCINVOKE=y
```

## arch/arm64/configs/old_NOS/elsa_storage_type_ufs_defconfig
```kconfig
# ADDITIONAL OPTIONS - START
CONFIG_SCSI_UFSHCD=y
CONFIG_SCSI_UFSHCD_PLATFORM=y
CONFIG_SCSI_UFS_QCOM=y
CONFIG_SCSI_UFS_QCOM_ICE=y
CONFIG_UFS_LGE_FEATURE=y
CONFIG_UFS_FAULT_INJECTION=y
CONFIG_UFS_LGE_CARD_RESET=y
CONFIG_UFS_LGE_CARD_RESET_DEBUGFS=y
# ADDITIONAL OPTIONS - END
CONFIG_QCOM_SMCINVOKE=y
```

## arch/arm64/configs/phx_defconfig
```kconfig
include elsa_tmo_us-perf_defconfig

CONFIG_NFS_FS=y
CONFIG_NFS_V2=y
CONFIG_NFS_V3=y
# CONFIG_NFS_V3_ACL is not set
CONFIG_NFS_V4=y
# CONFIG_NFS_SWAP is not set
# CONFIG_NFS_V4_1 is not set
# CONFIG_ROOT_NFS is not set
# CONFIG_NFS_USE_LEGACY_DNS is not set
CONFIG_NFS_USE_KERNEL_DNS=y
# CONFIG_NFSD is not set
CONFIG_NFS_COMMON=y

# Gentoo Stuff
CONFIG_CGROUPS=y
CONFIG_NAMESPACES=y
CONFIG_SYSVIPC=y
CONFIG_IPC_NS=y
CONFIG_NET_NS=y  
CONFIG_PID_NS=y
#we want devpts with gid=5 not the android gid
CONFIG_DEVPTS_MULTIPLE_INSTANCES=y
```

## drivers/bluetooth/broadcom/Kconfig
```kconfig
menu "BROADCOM V4L2 BT/FM device drivers"
  depends on BT

config BT_PROTOCOL_DRIVER
	tristate "BROADCOM BT Protocol Driver"
	default m

config LINE_DISCIPLINE_DRIVER
	tristate "BROADCOM Line Discipline Driver"
	default m

config V4L2_FM_DRIVER
	tristate "BROADCOM V4L2 FM Driver"
	default m

endmenu
```

## drivers/brcm_v4l2/Kconfig
```kconfig
menu "Broadcom Shared transport driver"
	depends on BT

config BRCM_V4L2
	tristate "Enable Broadcom Shared Transport based solution"
	help
	  Enable Broadcom Shared transport driver based solution.

	  Say Y here to compile support for Broadcom shared transport based
	  solution or say N to exclude.

config SH_V4L2
	tristate "Shared transport driver"
	help
	  Shared transport driver for UART.
          This driver is required if you want to use BT/FM/Ant via
          shared UART. These could be enabled using below flags.

	  Say Y here to compile support for Broadcom shared transport driver
	  or say M to compile is as a module (brcm_ldisc).

config BT_V4L2
	tristate "Bluetooth protocol driver"
	depends on SH_V4L2
	help
	  Bluetooth protocol driver.
	  This driver is required if you want to use Bluetooth via
	  the shared transport driver over UART.

	  Say Y here to compile support for Bluetooth protocol driver into the
	  kernel or say M to compile it as module (btdrv).

config FM_V4L2
	tristate "FM protocol driver"
	depends on SH_V4L2
	help
	  FM Radio protocol driver.
	  This driver is required if you want to use FM via
	  the shared transport driver over UART.

	  Say Y here to compile support for FM Radio into the
	  kernel or say M to compile it as module (fmdrv).

config ANT_V4L2
	tristate "FM protocol driver"
	depends on SH_V4L2
	help
	  ANT protocol driver.
	  This driver is required if you want to use ANT via
	  the shared transport driver over UART.

	  Say Y here to compile support for ANT into the
	  kernel or say M to compile it as module (antdrv).

endmenu
```
