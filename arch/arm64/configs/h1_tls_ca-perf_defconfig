## arch/arm64/configs/lge_msm8996_defconfig
```kconfig
include msm-perf_defconfig

# LG Platform
CONFIG_MACH_LGE=y

# ARM
CONFIG_NR_CPUS=4
CONFIG_CPUSETS=y
CONFIG_PROC_PID_CPUSET=y

# CPU - EAS
CONFIG_APSS_CORE_EA=n
CONFIG_PELT_UTIL_HALFLIFE_16=y
CONFIG_CPU_FREQ_GOV_SCHEDUTIL=y
CONFIG_CPU_FREQ_DEFAULT_GOV_SCHEDUTIL=y
CONFIG_DEFAULT_USE_ENERGY_AWARE=y
CONFIG_SCHED_WALT=y
CONFIG_SCHED_TUNE=y
CONFIG_CGROUP_SCHEDTUNE=y
#CONFIG_RCU_BOOST=y # Not set on wahoo
# We should probably not use perfd, but keep as reminder
CONFIG_MSM_PERFORMANCE=n
#CONFIG_MSM_PERFORMANCE_HOTPLUG_ON=n
#CONFIG_MSM_PERFORMANCE_CPUFREQ_LIMITS_VOTING_ONLY=y

# Useful for Android
CONFIG_IPV6_VTI=y
CONFIG_CRYPTO_GCM=y
CONFIG_CRYPTO_SHA512=y
CONFIG_TASK_DELAY_ACCT=y
CONFIG_BLK_DEV_IO_TRACE=y

# BPF
CONFIG_BPF_JIT=y
CONFIG_BPF_JIT_ALWAYS_ON=y
CONFIG_BPF_SYSCALL=y
CONFIG_CGROUP_BPF=y
CONFIG_KPROBES=y
CONFIG_NET_ACT_BPF=y
CONFIG_NET_CLS_BPF=y
CONFIG_SOCK_CGROUP_DATA=y
CONFIG_NETFILTER_XT_MATCH_BPF=y
CONFIG_NETFILTER_XT_MATCH_OWNER=y

# Bluetooth
CONFIG_BRCM_V4L2=y
# Barebones driver
CONFIG_BT_BCM43XX=n
CONFIG_BT_MSM_SLEEP=n

# Fingerprint Cards
CONFIG_INPUT_FINGERPRINT=y
CONFIG_INPUT_FINGERPRINT_FPC1020=y

# NXP
CONFIG_NFC=y
CONFIG_NFC_PN548=y

# For GPS - need rom support (DR_SYNC_ENABLED)
CONFIG_PPS=n
CONFIG_PPS_CLIENT_GPIO=n

# LGE - Camera
CONFIG_LG_OIS=y
CONFIG_LGE_CAM_PREVIEW_TUNE=y

# LGE - Sound
CONFIG_SND_LGE_MABL=n
CONFIG_SND_LGE_EFFECT=n
CONFIG_SND_LGE_NORMALIZER=n

# LGE - Display
CONFIG_LGE_VSYNC_SKIP=y
CONFIG_LGE_PANEL_RECOVERY=y
CONFIG_LGE_DISPLAY_COMMON=y
CONFIG_LGE_LCD_OFF_DIMMING=y
CONFIG_LGE_PP_AD_SUPPORTED=y
CONFIG_LGE_HIGH_LUMINANCE_MODE=y
CONFIG_LGE_SP_MIRRORING_CTRL_BL=y
CONFIG_LGE_DISPLAY_AOD_SUPPORTED=y
CONFIG_LGE_DISPLAY_LABIBB_RECOVERY=y
CONFIG_LGE_LCD_DYNAMIC_CABC_MIE_CTRL=y
CONFIG_LGE_DISPLAY_OVERRIDE_MDSS_DSI_PANEL_POWER_ON=y
CONFIG_LGE_DISPLAY_OVERRIDE_MDSS_DSI_PANEL_POWER_OFF=y
CONFIG_LGE_DISPLAY_OVERRIDE_MDSS_DSI_PANEL_ON=y
CONFIG_LGE_DISPLAY_OVERRIDE_MDSS_DSI_PANEL_OFF=y
CONFIG_LGE_DISPLAY_OVERRIDE_MDSS_DSI_PANEL_RESET=y
CONFIG_LGE_DISPLAY_OVERRIDE_MDSS_DSI_CTRL_SHUTDOWN=y

# PM
CONFIG_LGE_PM=y
CONFIG_QPNP_FG_EXTENSION=y
CONFIG_QPNP_SMBCHARGER_EXTENSION=y

# USB
CONFIG_LGE_USB_TYPE_C=y
CONFIG_DUAL_ROLE_USB_INTF=y

# Other
CONFIG_SLIMBUS=y
CONFIG_MFD_H1_DSV=y
CONFIG_WQ_POWER_EFFICIENT_DEFAULT=y

# EXT Filesystems
CONFIG_EXT2_FS=n
CONFIG_EXT3_FS=n
CONFIG_EXT4_ENCRYPTION=y
CONFIG_EXT4_FS_ENCRYPTION=y
CONFIG_EXT4_USE_FOR_EXT23=y

# DOS/FAT/NT Filesystems
CONFIG_MSDOS_FS=n
CONFIG_VFAT_FS=n
CONFIG_SDFAT_FS=y
CONFIG_SDFAT_USE_FOR_EXFAT=y
CONFIG_SDFAT_USE_FOR_VFAT=y
CONFIG_SDFAT_DELAYED_META_DIRTY=y
CONFIG_SDFAT_SUPPORT_DIR_SYNC=y
CONFIG_SDFAT_DEFAULT_CODEPAGE=437
CONFIG_SDFAT_DEFAULT_IOCHARSET="utf8"
CONFIG_SDFAT_CHECK_RO_ATTR=y
CONFIG_SDFAT_ALIGNED_MPAGE_WRITE=y
CONFIG_SDFAT_VIRTUAL_XATTR=y
CONFIG_SDFAT_VIRTUAL_XATTR_SELINUX_LABEL="u:object_r:sdcard_external:s0"
CONFIG_SDFAT_DEBUG=n
CONFIG_SDFAT_SUPPORT_STLOG=y
CONFIG_SDFAT_STATISTICS=y

# Treble
CONFIG_CP15_BARRIER_EMULATION=y
CONFIG_SETEND_EMULATION=y
CONFIG_SECURITY_PERF_EVENTS_RESTRICT=y

# Vibrator
CONFIG_QPNP_HAPTIC=y

# Disable QCOM drivers to avoid confliction
CONFIG_BT_RFCOMM=n
CONFIG_MSM_BT_POWER=n
CONFIG_NFC_NQ=n
CONFIG_CNSS=n
CONFIG_USELIB=n

# mk2000 has override priority
include mk2k_config
```

## arch/arm64/configs/lineageos_h830_defconfig
```kconfig
include lineageos_alice_common
# LG Platform
CONFIG_MACH_MSM8996_H1_TMO_US=y

# Broadcom - Wifi
CONFIG_BCMDHD=y
CONFIG_BCMDHD_LEGACY=y
CONFIG_BCMDHD_PCIE=y
CONFIG_BCM4358=y
CONFIG_BCMDHD_COB=y
CONFIG_BCMDHD_USE_SCHED_SCAN=y
CONFIG_BCMDHD_FOLLOW_AP_DTIM_PERIOD=n
CONFIG_WIFI_CONTROL_FUNC=y
```

## arch/arm64/configs/lineageos_h870_defconfig
```kconfig
include lineageos_lucye_common
# LG Platform
CONFIG_MACH_MSM8996_LUCYE_GLOBAL_COM=y

# Broadcom - Wifi
CONFIG_BCMDHD=y
CONFIG_BCMDHD_LEGACY=y
CONFIG_BCMDHD_PCIE=y
CONFIG_BCM43455=y
CONFIG_BCMDHD_COB=y
CONFIG_BCMDHD_USE_SCHED_SCAN=y
CONFIG_BCMDHD_FOLLOW_AP_DTIM_PERIOD=n
CONFIG_WIFI_CONTROL_FUNC=y
```

## arch/arm64/configs/lineageos_h990_defconfig
```kconfig
include lineageos_elsa_common
# LG Platform
CONFIG_MACH_MSM8996_ELSA_GLOBAL_COM=y

# Broadcom - Wifi
CONFIG_BCMDHD=y
CONFIG_BCMDHD_LEGACY=y
CONFIG_BCMDHD_PCIE=y
CONFIG_BCM43455=y
CONFIG_BCMDHD_COB=y
CONFIG_BCMDHD_USE_SCHED_SCAN=y
CONFIG_BCMDHD_FOLLOW_AP_DTIM_PERIOD=n
CONFIG_WIFI_CONTROL_FUNC=y


# Required for functioning modem
CONFIG_DIRTYSANTA_FIXUP=y

# Wipes out the incorrect modem parameters
CONFIG_CMDLINE_SEARCHREPLACE=y
CONFIG_CMDLINE_SAR_ENABLE0=y
CONFIG_CMDLINE_SAR_SEARCH0=" model.name=LG-US996 "
CONFIG_CMDLINE_SAR_REPLACE0=" "
CONFIG_CMDLINE_SAR_ENABLE1=y
CONFIG_CMDLINE_SAR_SEARCH1=" androidboot.serialno=LGUS996"
CONFIG_CMDLINE_SAR_REPLACE1=" androidboot.serialno=LGH990"
```

## arch/arm64/configs/lineageos_us997_defconfig
```kconfig
include lineageos_lucye_common
# LG Platform
CONFIG_MACH_MSM8996_LUCYE_NAO_US=y

# Broadcom - Wifi
CONFIG_BCMDHD=y
CONFIG_BCMDHD_EXT=y
CONFIG_BCMDHD_PCIE=y
CONFIG_BCM4359=y
CONFIG_BCMDHD_COB=y
CONFIG_BCMDHD_USE_SCHED_SCAN=y
CONFIG_BCMDHD_HOSTAPD_BGN_MODE=y
CONFIG_BCMDHD_FOLLOW_AP_DTIM_PERIOD=n
CONFIG_WIFI_CONTROL_FUNC=y

# LGE - PM
CONFIG_IDTP9223_CHARGER=y

# LGE - Sound
CONFIG_SND_USE_QUAT_MI2S=y
```

## arch/arm64/configs/lucye_acg_us-debug_defconfig
```kconfig
include lucye_acg_us_common
include lucye_common-debug
CONFIG_MEM_SHARE_QMI_SERVICE=y
```

## arch/arm64/configs/lucye_acg_us-perf_defconfig
```kconfig
include lucye_acg_us_common
include lucye_common-perf
CONFIG_LGE_USB_DIAG_LOCK_VZW=y
```

## arch/arm64/configs/lucye_global_com-debug_defconfig
```kconfig
include lucye_global_com_common
include lucye_common-debug
CONFIG_MEM_SHARE_QMI_SERVICE=y
```

## arch/arm64/configs/lucye_global_com_dac-debug_defconfig
```kconfig
include lucye_global_com_dac_common
include lucye_common-debug
CONFIG_MEM_SHARE_QMI_SERVICE=y
```

## arch/arm64/configs/lucye_global_ldu-debug_defconfig
```kconfig
include lucye_global_ldu_common
include lucye_common-debug
CONFIG_MEM_SHARE_QMI_SERVICE=y
```
