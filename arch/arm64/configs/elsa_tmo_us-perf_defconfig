## arch/arm64/configs/elsa_usc_us-perf_defconfig
```kconfig
include elsa_usc_us_common
include elsa_common-perf
#############################################################
#   Fix kernel command-line (may or may not be important)   #
#############################################################
CONFIG_CMDLINE_SEARCHREPLACE=y
CONFIG_CMDLINE_SAR_VERIFY_GREEN=y
CONFIG_CMDLINE_SAR_ENABLE0=y
CONFIG_CMDLINE_SAR_SEARCH0=" slub_debug=FZPU "
CONFIG_CMDLINE_SAR_REPLACE0=" "
CONFIG_CMDLINE_SAR_ENABLE1=y
CONFIG_CMDLINE_SAR_SEARCH1=" androidboot.enable_dm_verity="
CONFIG_CMDLINE_SAR_REPLACE1=" "
CONFIG_CMDLINE_SAR_ENABLE2=y
CONFIG_CMDLINE_SAR_SEARCH2=" androidboot.veritymode="
CONFIG_CMDLINE_SAR_REPLACE2=" "
CONFIG_CMDLINE_SAR_ENABLE3=y
CONFIG_CMDLINE_SAR_SEARCH3=" androidboot.secboot="
CONFIG_CMDLINE_SAR_REPLACE3=" "
```

## arch/arm64/configs/h1_clr_pr-perf_defconfig
```kconfig
include h1_clr_pr_common
include h1_common-perf
CONFIG_LGP_DATA_TCPIP_SLAAC_IPV6_ALLOCATION_BOOSTER=y
CONFIG_LGP_DATA_BUGFIX_IPV6_ADDRCONF_KERNEL_CRASH=y
```

## arch/arm64/configs/h1_lra_us-debug_defconfig
```kconfig
include h1_lra_us_common
include h1_common-debug
CONFIG_MEM_SHARE_QMI_SERVICE=y
CONFIG_CORESIGHT=y
CONFIG_CORESIGHT_EVENT=y
CONFIG_CORESIGHT_FUSE=y
CONFIG_CORESIGHT_CTI=y
CONFIG_CORESIGHT_TMC=y
CONFIG_CORESIGHT_TPIU=y
CONFIG_CORESIGHT_FUNNEL=y
CONFIG_CORESIGHT_REPLICATOR=y
CONFIG_CORESIGHT_TPDA=y
CONFIG_CORESIGHT_TPDM=y
CONFIG_CORESIGHT_STM=y
CONFIG_CORESIGHT_HWEVENT=y
CONFIG_CORESIGHT_ETMV4=y
CONFIG_CORESIGHT_REMOTE_ETM=y
CONFIG_CORESIGHT_QPDI=y
```
