## arch/arm64/configs/bootchart2_defconfig
```kconfig
CONFIG_TASKSTATS=y
CONFIG_TASK_DELAY_ACCT=y
CONFIG_TASK_XACCT=y
CONFIG_TASK_IO_ACCOUNTING=y
CONFIG_CONNECTOR=y
CONFIG_PROC_EVENTS=y
CONFIG_PRINTK_TIME=y
CONFIG_LOG_BUF_SHIFT=21
```

## arch/arm64/configs/elsa_cno_cn-debug_defconfig
```kconfig
include elsa_cno_cn_common
include elsa_common-debug
CONFIG_MEM_SHARE_QMI_SERVICE=y
```

## arch/arm64/configs/elsa_global_com-debug_defconfig
```kconfig
include elsa_global_com_common
include elsa_common-debug
CONFIG_MEM_SHARE_QMI_SERVICE=y
```

## arch/arm64/configs/elsa_global_com_mimo-debug_defconfig
```kconfig
include elsa_global_com_mimo_common
include elsa_common-debug
CONFIG_MEM_SHARE_QMI_SERVICE=y
```

## arch/arm64/configs/elsa_kt_kr-perf_defconfig
```kconfig
include elsa_kt_kr_common
include elsa_common-perf
#############################################################
#   Fix kernel command-line (may or may not be important)   #
#############################################################
CONFIG_CMDLINE="androidboot.bl_unlock_complete=false androidboot.authorized_kernel=true"
CONFIG_CMDLINE_EXTEND=y
CONFIG_CMDLINE_SEARCHREPLACE=y
CONFIG_CMDLINE_SAR_VERIFY_GREEN=y
CONFIG_CMDLINE_SAR_ENABLE0=y
CONFIG_CMDLINE_SAR_SEARCH0=" model.name=LG-US996 "
CONFIG_CMDLINE_SAR_REPLACE0=" model.name=LG-F800k "
CONFIG_CMDLINE_SAR_ENABLE1=y
CONFIG_CMDLINE_SAR_SEARCH1=" androidboot.serialno=LGUS996"
CONFIG_CMDLINE_SAR_REPLACE1=" androidboot.serialno=LGF800"
CONFIG_CMDLINE_SAR_ENABLE2=y
CONFIG_CMDLINE_SAR_SEARCH2=" slub_debug=FZPU "
CONFIG_CMDLINE_SAR_REPLACE2=" "
CONFIG_CMDLINE_SAR_ENABLE3=y
CONFIG_CMDLINE_SAR_SEARCH3=" androidboot.enable_dm_verity="
CONFIG_CMDLINE_SAR_REPLACE3=" "
CONFIG_CMDLINE_SAR_ENABLE4=y
CONFIG_CMDLINE_SAR_SEARCH4=" androidboot.veritymode="
CONFIG_CMDLINE_SAR_REPLACE4=" "
CONFIG_CMDLINE_SAR_ENABLE5=y
CONFIG_CMDLINE_SAR_SEARCH5=" androidboot.secboot="
CONFIG_CMDLINE_SAR_REPLACE5=" "
```

## arch/arm64/configs/elsa_nao_us-perf_defconfig
```kconfig
include elsa_nao_us_common
include elsa_common-perf
CONFIG_LGE_DIRTY_ABOOT_FIXUP=n
```

## arch/arm64/configs/elsa_nao_us_dirty-perf_defconfig
```kconfig
include elsa_nao_us_common
include elsa_common-perf
#############################################################
#   Fix kernel command-line (may or may not be important)   #
#############################################################
CONFIG_CMDLINE="androidboot.bl_unlock_complete=false androidboot.authorized_kernel=true"
CONFIG_CMDLINE_EXTEND=y
CONFIG_CMDLINE_SAR_ENABLE0=y
CONFIG_CMDLINE_SAR_SEARCH0=" slub_debug=FZPU "
CONFIG_CMDLINE_SAR_REPLACE0=" "
```
